ENTRY(_start)

SECTIONS
{
  . = 0x400;

  .text :
  {
    */lv0ldr/src/boot/crt0.o(.text)
    */lv0ldr/src/boot/main.o(.text.main)
    */lv0ldr/src/dma/dma.o(.text._Z8dma_waitv)
    */lv0ldr/src/dma/dma.o(.text._Z21copy_qwords_from_mmioyPcj)
    */lv0ldr/src/boot/loader.o(.text._ZN6loaderC1Ev)
    */lv0ldr/src/boot/loader.o(.text._ZN6loaderC2Ev)
    */lv0ldr/src/boot/loader.o(.text._ZN6loader8finalizeEb)
    */lv0ldr/src/boot/loader.o(.text._ZN6loader8find_lv0EPy)
    */lv0ldr/src/boot/loader.o(.text._ZN6loader3runEv)
    */lv0ldr/src/boot/loader.o(.text._ZN6loader9find_fileEyPKcPyS2_)
    */lv0ldr/src/boot/loader.o(.text._ZN6loader12find_lv0_rosEyPy)
    */lv0ldr/src/boot/loader.o(.text._ZN6loader12find_updaterEyPy)
    */lv0ldr/src/boot/loader.o(.text._ZN6loader12print_bannerEv)
    */lv0ldr/src/util/mmio_access.o(.text._Z6read64y)
    */lv0ldr/src/boot/loader.o(.text._ZN6loader13find_lv0_bankEyPy)
    */lv0ldr/src/boot/loader.o(.text._ZN6loader14find_lv0_flashEyPy)
    */lv0ldr/src/boot/loader.o(.text._ZN6loader15find_lv0_updateEyPy)
    */lv0ldr/src/boot/loader.o(.text._ZN6loader4haltEv)
    */lv0ldr/src/util/mmio_access.o(.text._Z7write32yj)
    */lv0ldr/src/boot/loader.o(.text._ZN6loader5startEv)
    */lv0ldr/src/boot/loader.o(.text._ZN6loader7handoffEv)
    */lv0ldr/src/boot/loader.o(.text._ZN6loader8load_lv0Ey)
    */lv0ldr/src/auth/loader_auth.o(.text._ZN11loader_base17check_config_ringEv)
    *(.gnu.linkonce.t._ZN13authenticatorD1Ev)
    */lv0ldr/src/auth/loader_auth.o(.text._Z41__static_initialization_and_destruction_0ii)
    */lv0ldr/src/auth/loader_auth.o(.text._GLOBAL__I_lv0_header_key)
    */lv0ldr/src/auth/loader_auth.o(.text._GLOBAL__D_lv0_header_key)
    */lv0ldr/src/platform/config_ring.o(.text._ZN11config_ring8cmp_bitsEPKhS1_tt)
    */lv0ldr/src/platform/config_ring.o(.text._ZN11config_ring6verifyEv)
    */lv0ldr/src/flash/ros_header.o(.text._Z15ros_read_headeryP14ros_toc_header)
    */lv0ldr/src/util/strncmp.o(.text.strncmp)
    */lv0ldr/src/util/memcpy.o(.text.memcpy)
    */lv0ldr/src/flash/ros_entry.o(.text._Z14ros_find_entryyjPKcP13ros_toc_entry)
    *(.gnu.linkonce.t._ZN9elf_imageC1Ev)
    */lv0ldr/src/auth/authenticator.o(.text._ZN9elf_image4loadEPKv)
    *(.gnu.linkonce.t._ZN6cipherD2Ev)
    *(.gnu.linkonce.t._ZN6cipherD1Ev)
    *(.gnu.linkonce.t._ZN6cipherD0Ev)
    *(.gnu.linkonce.t._ZN17aes128_ctr_cipherD1Ev)
    *(.gnu.linkonce.t._ZN17aes128_ctr_cipherD0Ev)
    *(.gnu.linkonce.t._ZN17aes256_cbc_cipherD1Ev)
    *(.gnu.linkonce.t._ZN17aes256_cbc_cipherD0Ev)
    *(.gnu.linkonce.t._ZN17aes128_cbc_cipherD1Ev)
    *(.gnu.linkonce.t._ZN17aes128_cbc_cipherD0Ev)
    *(.gnu.linkonce.t._ZN8verifierD2Ev)
    *(.gnu.linkonce.t._ZN8verifierD1Ev)
    *(.gnu.linkonce.t._ZN8verifierD0Ev)
    *(.gnu.linkonce.t._ZN14ecdsa_verifierD1Ev)
    *(.gnu.linkonce.t._ZN14ecdsa_verifierD0Ev)
    */lv0ldr/src/auth/authenticator.o(.text._ZN13authenticatorC1Ev)
    */lv0ldr/src/auth/authenticator.o(.text._ZN13authenticatorC2Ev)
    */lv0ldr/src/auth/authenticator.o(.text._ZN13authenticator10set_offsetEy)
    */lv0ldr/src/auth/authenticator.o(.text._ZN13authenticator11load_headerEjPKhS1_S1_PKjPP10dma_bufferj)
    */lv0ldr/src/auth/authenticator.o(.text._ZN13authenticator15read_elf_headerEP10Elf64_Ehdr)
    */lv0ldr/src/auth/authenticator.o(.text._ZN13authenticator19read_program_headerEjP10Elf64_Phdr)
    */lv0ldr/src/auth/auth_options.o(.text._ZN10auth_state4loadEPK10auth_entry)
    */lv0ldr/src/util/memset.o(.text.memset)
    */lv0ldr/src/auth/auth_segments.o(.text._ZN10auth_stateC2Ev)
    */lv0ldr/src/auth/auth_segments.o(.text._ZN10auth_stateC1Ev)
    */lv0ldr/src/auth/auth_segments.o(.text._ZN13authenticator12load_segmentEjjyPP10dma_bufferiS2_i)
    */lv0ldr/src/auth/auth_transfer.o(.text._ZN13authenticator18transfer_encryptedEv)
    */lv0ldr/src/auth/auth_transfer.o(.text._ZN13authenticator14transfer_plainEv)
    */lv0ldr/src/auth/auth_transfer.o(.text._ZN13authenticator10check_typeEj)
    */lv0ldr/src/auth/auth_transfer.o(.text._ZN13authenticator12find_sectionEjjP12auth_section)
    */lv0ldr/src/auth/auth_transfer.o(.text._ZN13authenticator16check_sce_headerEjPK10sce_header)
    */lv0ldr/src/util/memcmp.o(.text.memcmp)
    */lv0ldr/src/auth/auth_buffers.o(.text._ZN13authenticator21verify_section_digestEPK12auth_section)
    */lv0ldr/src/auth/auth_buffers.o(.text._ZN9auth_sink6appendEPKU8__vectorhS2_)
    */lv0ldr/src/auth/auth_buffers.o(.text._ZN13authenticator16drain_read_queueEv)
    */lv0ldr/src/auth/auth_buffers.o(.text._ZN13authenticator17save_header_pieceEPK10dma_buffer)
    */lv0ldr/src/auth/auth_buffers.o(.text._ZN13authenticator20restore_header_pieceEPK10dma_buffer)
    */lv0ldr/src/auth/auth_buffers.o(.text._ZN10auth_blockC2Ev)
    */lv0ldr/src/auth/auth_buffers.o(.text._ZN10auth_blockC1Ev)
    */lv0ldr/src/auth/auth_buffers.o(.text._ZN10auth_block4loadEPK10auth_entry)
    */lv0ldr/src/auth/cipher_aes256_cbc.o(.text._ZN17aes256_cbc_cipher7set_keyEPKhPK9cipher_iv)
    */lv0ldr/src/auth/cipher_aes256_cbc.o(.text._ZN17aes256_cbc_cipher7decryptEPKviPv)
    *(.gnu.linkonce.t._ZN17aes256_cbc_cipherC1Ev)
    */lv0ldr/src/auth/cipher_aes256_cbc.o(.text._Z41__static_initialization_and_destruction_0ii)
    */lv0ldr/src/auth/cipher_aes256_cbc.o(.text._GLOBAL__D_g_aes256_cbc)
    */lv0ldr/src/auth/cipher_aes256_cbc.o(.text._GLOBAL__I_g_aes256_cbc)
    */lv0ldr/src/auth/cipher_aes128_cbc.o(.text._ZN17aes128_cbc_cipher7set_keyEPKhPK9cipher_iv)
    */lv0ldr/src/auth/cipher_aes128_cbc.o(.text._ZN17aes128_cbc_cipher7decryptEPKviPv)
    *(.gnu.linkonce.t._ZN17aes128_cbc_cipherC1Ev)
    */lv0ldr/src/auth/cipher_aes128_cbc.o(.text._Z41__static_initialization_and_destruction_0ii)
    */lv0ldr/src/auth/cipher_aes128_cbc.o(.text._GLOBAL__D_g_aes128_cbc)
    */lv0ldr/src/auth/cipher_aes128_cbc.o(.text._GLOBAL__I_g_aes128_cbc)
    */lv0ldr/src/auth/cipher_aes128_ctr.o(.text._ZN17aes128_ctr_cipher7set_keyEPKhPK9cipher_iv)
    */lv0ldr/src/auth/cipher_aes128_ctr.o(.text._ZN17aes128_ctr_cipher7decryptEPKviPv)
    *(.gnu.linkonce.t._ZN17aes128_ctr_cipherC1Ev)
    */lv0ldr/src/auth/cipher_aes128_ctr.o(.text._Z41__static_initialization_and_destruction_0ii)
    */lv0ldr/src/auth/cipher_aes128_ctr.o(.text._GLOBAL__D_g_aes128_ctr)
    */lv0ldr/src/auth/cipher_aes128_ctr.o(.text._GLOBAL__I_g_aes128_ctr)
    */lv0ldr/src/auth/verifier_ecdsa.o(.text._ZN14ecdsa_verifierC1EPKhj)
    */lv0ldr/src/auth/verifier_ecdsa.o(.text._ZN14ecdsa_verifierC2EPKhj)
    */lv0ldr/src/auth/verifier_ecdsa.o(.text._ZN14ecdsa_verifier6verifyEPKhiS1_)
    */lv0ldr/src/auth/hmac_digest.o(.text._ZN11hmac_digestC1Ev)
    */lv0ldr/src/auth/hmac_digest.o(.text._ZN11hmac_digestC2Ev)
    */lv0ldr/src/auth/hmac_digest.o(.text._ZN11hmac_digest4initEPKhj)
    */lv0ldr/src/auth/hmac_digest.o(.text._ZN11hmac_digest5finalEPh)
    */lv0ldr/src/auth/hmac_digest.o(.text._ZN11hmac_digest6updateEPKhi)
    */lv0ldr/src/auth/hmac_digest.o(.text._Z41__static_initialization_and_destruction_0ii)
    */lv0ldr/src/auth/hmac_digest.o(.text._GLOBAL__I_g_hmac)
    */lv0ldr/src/auth/hmac_digest.o(.text._GLOBAL__D_g_hmac)
    */lv0ldr/src/auth/elf_reader.o(.text._ZN13authenticator7prependEP10dma_bufferj)
    */lv0ldr/src/auth/elf_reader.o(.text._ZN9elf_image10get_headerEP10Elf64_Ehdr)
    */lv0ldr/src/auth/elf_reader.o(.text._ZN9elf_image18get_program_headerEjP10Elf64_Phdr)
    */lv0ldr/src/dma/dma_queue.o(.text._ZN9dma_queue11add_writtenEP10dma_buffer)
    */lv0ldr/src/dma/dma_queue.o(.text._ZN9dma_queue4openEyjyj)
    */lv0ldr/src/dma/dma_queue.o(.text._ZN9dma_queueC2Ev)
    */lv0ldr/src/dma/dma_queue.o(.text._ZN9dma_queueC1Ev)
    */lv0ldr/src/dma/dma_queue.o(.text._ZN9dma_queue12enqueue_readEP10dma_buffer)
    */lv0ldr/src/dma/dma_queue.o(.text._ZN9dma_queue13enqueue_writeEP10dma_buffer)
    */lv0ldr/src/dma/dma_queue.o(.text._ZN9dma_queue7dequeueEPP10dma_bufferP9list_nodeMS0_FbvE)
    */lv0ldr/src/dma/dma_queue.o(.text._ZN9dma_queue5drainEP9list_nodeM10dma_bufferFbvE)
    */lv0ldr/src/dma/dma_queue.o(.text._ZN9dma_queue5closeEv)
    */lv0ldr/src/dma/dma_queue.o(.text._ZN9dma_queue13dequeue_writeEPP10dma_buffer)
    */lv0ldr/src/dma/dma_queue.o(.text._ZN9dma_queue12dequeue_readEPP10dma_buffer)
    */lv0ldr/src/dma/dma_queue.o(.text._ZN10list_entryC1Ev)
    */lv0ldr/src/dma/dma_queue.o(.text._ZN10list_entryC2Ev)
    */lv0ldr/src/dma/dma_buffer.o(.text._ZN10dma_bufferC2Ev)
    */lv0ldr/src/dma/dma_buffer.o(.text._ZN10dma_bufferC1Ev)
    */lv0ldr/src/dma/dma_buffer.o(.text._ZN10dma_buffer10set_bufferEjj)
    */lv0ldr/src/dma/dma_buffer.o(.text._ZN17tagged_dma_bufferC2Ej)
    */lv0ldr/src/dma/dma_buffer.o(.text._ZN17tagged_dma_bufferC1Ej)
    */lv0ldr/src/dma/dma_buffer.o(.text._ZN17tagged_dma_buffer8get_doneEv)
    */lv0ldr/src/dma/dma_buffer.o(.text._ZN17tagged_dma_buffer8put_doneEv)
    */lv0ldr/src/dma/dma_buffer.o(.text._ZN17tagged_dma_buffer9max_chunkEj)
    */lv0ldr/src/dma/dma_buffer.o(.text._ZN17tagged_dma_buffer8transferEyyjj)
    *(.gnu.linkonce.t._ZN7dma_mfcC1Ev)
    */lv0ldr/src/dma/dma_buffer.o(.text._Z41__static_initialization_and_destruction_0ii)
    */lv0ldr/src/dma/dma_buffer.o(.text._GLOBAL__I__ZN10dma_bufferC2Ev)
    */lv0ldr/src/dma/dma_buffer_io.o(.text._ZN17tagged_dma_buffer3putEyjPj)
    */lv0ldr/src/dma/dma_buffer_io.o(.text._ZN17tagged_dma_buffer3getEyjPj)
    */lv0ldr/crypto/aes_modes.o(.text)
    */lv0ldr/crypto/sha1_digest.o(.text)
    */lv0ldr/crypto/hmac_sha1.o(.text)
    */lv0ldr/crypto/aes.o(.text)
    */lv0ldr/crypto/sha1.o(.text)
    */lv0ldr/crypto/sha1_transform.o(.text)
    */lv0ldr/crypto/ecdsa_id.o(.text)
    */lv0ldr/crypto/ec_curves.o(.text)
    */lv0ldr/crypto/ecdsa.o(.text)
    */lv0ldr/crypto/ec.o(.text)
    */lv0ldr/crypto/ec_mul2.o(.text)
    */lv0ldr/crypto/bn.o(.text)
    */lv0ldr/crypto/bn_range.o(.text)
    */lv0ldr/crypto/ec_curve_valid.o(.text)
    */lv0ldr/src/dma/mfc.o(.text._ZN8mfc_baseC2Ev)
    */lv0ldr/src/dma/mfc.o(.text._ZN8mfc_baseC1Ev)
    */lv0ldr/src/dma/mfc.o(.text._Z9mfc_issuejyjjjj)
    */lv0ldr/src/dma/mfc.o(.text._Z12mfc_tag_donej)
    */lv0ldr/src/util/cxx_runtime.o(.text._ZdlPv)
    */lv0ldr/src/util/cxx_runtime.o(.text.__cxa_pure_virtual)
    */lv0ldr/src/xdr/xdr_config.o(.text._ZN3xdrD2Ev)
    */lv0ldr/src/xdr/xdr_config.o(.text._ZN3xdrD1Ev)
    */lv0ldr/src/xdr/xdr_config.o(.text._ZN3xdr10set_configEP13memory_config)
    */lv0ldr/src/util/mmio_access.o(.text._Z6read32y)
    */lv0ldr/src/boot/loader_unit.o(.text._Z16is_sb_product_dxv)
    */lv0ldr/src/boot/loader_unit.o(.text._Z28get_eeprom_select_net_devicePh)
    */lv0ldr/src/boot/loader_unit.o(.text._Z22get_eeprom_update_flagPh)
    */lv0ldr/src/boot/loader_unit.o(.text._Z26get_eeprom_boot_fir_configPh)
    */lv0ldr/src/boot/loader_unit.o(.text._Z23get_eeprom_bootrom_diagPh)
    */lv0ldr/src/boot/loader_unit.o(.text._Z16get_eeprom_48c0dPh)
    */lv0ldr/src/boot/loader_unit.o(.text._Z16get_eeprom_48c0ePh)
    */lv0ldr/src/boot/loader_unit.o(.text._Z30get_eeprom_bootrom_trace_levelPh)
    */lv0ldr/src/boot/loader_unit.o(.text._Z23set_eeprom_bootrom_diagh)
    */lv0ldr/src/boot/loader_unit.o(.text._Z16set_eeprom_48c0dh)
    */lv0ldr/src/boot/loader_unit.o(.text._Z16set_eeprom_48c0eh)
    */lv0ldr/src/boot/loader_unit.o(.text._Z27set_livelock_detection_modei)
    */lv0ldr/src/boot/loader_unit.o(.text._Z14get_sc_versionhPt)
    */lv0ldr/src/boot/loader_unit.o(.text._Z19get_boot_fir_configv)
    */lv0ldr/src/boot/loader_unit.o(.text._Z16get_bootrom_diagPh)
    */lv0ldr/src/boot/loader_unit.o(.text._Z21get_debug_device_namev)
    */lv0ldr/src/boot/loader_unit.o(.text._Z18get_flash_rom_basev)
    */lv0ldr/src/boot/loader_unit.o(.text._ZN11loader_base19is_sc_protocol_ver1Ev)
    */lv0ldr/src/boot/loader_unit.o(.text._Z16get_flash_layoutv)
    */lv0ldr/src/boot/loader_unit.o(.text._ZN11loader_base15get_update_flagEv)
    */lv0ldr/src/boot/loader_unit.o(.text._ZN11loader_base15is_force_updateEv)
    */lv0ldr/src/boot/loader_unit.o(.text._ZN11loader_base5printEPKc)
    */lv0ldr/src/boot/loader_unit.o(.text._Z24is_boot_memory_type_nandv)
    */lv0ldr/src/boot/loader_unit.o(.text._Z22release_dma_io_addressv)
    */lv0ldr/src/boot/loader_unit.o(.text._Z16is_config_2_zerov)
    */lv0ldr/src/boot/loader_unit.o(.text._Z24setup_livelock_detectionv)
    */lv0ldr/src/boot/loader_unit.o(.text._Z18handle_fatal_errorv)
    */lv0ldr/src/boot/loader_unit.o(.text._Z12post_code_aav)
    */lv0ldr/src/boot/loader_unit.o(.text._Z12post_code_01v)
    */lv0ldr/src/boot/loader_unit.o(.text._Z12post_code_02v)
    */lv0ldr/src/boot/loader_unit.o(.text._Z12post_code_03v)
    */lv0ldr/src/boot/loader_unit.o(.text._Z12post_code_05v)
    */lv0ldr/src/boot/loader_unit.o(.text._Z12post_code_06v)
    */lv0ldr/src/boot/loader_unit.o(.text._Z12post_code_07bb)
    */lv0ldr/src/boot/loader_unit.o(.text._Z12post_code_08v)
    */lv0ldr/src/boot/loader_unit.o(.text._Z12post_code_30v)
    */lv0ldr/src/boot/loader_unit.o(.text._Z18post_lv0_auth_failv)
    */lv0ldr/src/boot/loader_unit.o(.text._Z18post_lv0_not_foundv)
    */lv0ldr/src/boot/loader_unit.o(.text._Z22get_first_spu_priv1_20v)
    */lv0ldr/src/util/mmio_access.o(.text._Z7write64yy)
    */lv0ldr/src/boot/loader_unit.o(.text._ZN11loader_base8finalizeEb)
    */lv0ldr/src/boot/loader_unit.o(.text._ZN11loader_base11init_memoryEv)
    */lv0ldr/src/boot/loader_unit.o(.text._Z18sb_dx_write32_1c30yj)
    */lv0ldr/src/boot/loader_unit.o(.text._Z18sb_dx_write32_1c34yj)
    */lv0ldr/src/boot/loader_unit.o(.text._Z19init_nand_flash_dmayyy)
    */lv0ldr/src/boot/loader_unit.o(.text._ZN11loader_base19copy_to_main_memoryEyj)
    */lv0ldr/src/boot/loader_unit.o(.text._Z14write32_maskedyjj)
    */lv0ldr/src/boot/loader_unit.o(.text._Z19configure_sb_errorsb)
    */lv0ldr/src/boot/loader_unit.o(.text._Z19configure_be_errorsbb)
    */lv0ldr/src/boot/loader_unit.o(.text._ZN11loader_base10initializeEv)
    */lv0ldr/src/boot/memory_config.o(.text._Z14ata_activationyy)
    */lv0ldr/src/boot/memory_config.o(.text._ZN19memory_config_query10initializeEv)
    */lv0ldr/src/boot/memory_config.o(.text._ZN19memory_config_query6is_strEPb)
    */lv0ldr/src/boot/memory_config.o(.text._ZN19memory_config_query12query_configEP13memory_config)
    */lv0ldr/src/boot/memory_diag.o(.text._ZN13memory_testerC2Ev)
    */lv0ldr/src/boot/memory_diag.o(.text._ZN13memory_testerC1Ev)
    */lv0ldr/src/boot/memory_diag.o(.text._ZN13memory_tester11comp_memoryEyyPKU8__vectora)
    */lv0ldr/src/boot/memory_diag.o(.text._Z15get_memory_sizev)
    */lv0ldr/src/boot/memory_diag.o(.text._ZN13memory_tester4fillEyy)
    */lv0ldr/src/boot/memory_diag.o(.text._Z11memory_diagyjyh)
    */lv0ldr/src/platform/be_mmio.o(.text._ZN7be_mmio8delay_nsEj)
    */lv0ldr/src/platform/be_mmio.o(.text._ZN7be_mmio8delay_usEj)
    */lv0ldr/src/platform/be_mmio.o(.text._ZN7be_mmio7write64Ejjj)
    */lv0ldr/src/platform/be_mmio.o(.text._ZN7be_mmio14set_mic_timingEjtt)
    */lv0ldr/src/platform/be_mmio.o(.text._ZN7be_mmio16set_mic_timing_bEjjt)
    */lv0ldr/src/xdr/xdr.o(.text._ZN3xdr5errorEPKc)
    */lv0ldr/src/xdr/xdr.o(.text._ZN3xdr4infoEPKc)
    */lv0ldr/src/xdr/xdr.o(.text._ZN3xdr10fill_starsEPci)
    */lv0ldr/src/xdr/xdr.o(.text._ZN3xdr13wake_from_strEv)
    */lv0ldr/src/xdr/xdr.o(.text._ZN3xdr16enable_scrubbingEv)
    */lv0ldr/src/xdr/xdr.o(.text._ZN3xdr12print_bannerEv)
    */lv0ldr/src/xdr/xdr.o(.text._ZN3xdr15validate_configEv)
    */lv0ldr/src/xdr/xdr.o(.text._ZN3xdr5beginEv)
    */lv0ldr/src/xdr/xdr.o(.text._ZN3xdr9load_rowsEPt)
    */lv0ldr/src/xdr/xdr.o(.text._ZN3xdr8bank_mapEij)
    *(.gnu.linkonce.t._ZN3xdr6timingEiii)
    */lv0ldr/src/xdr/xdr.o(.text._ZN3xdr7permuteEt)
    */lv0ldr/src/xdr/xdr.o(.text._ZN3xdr20store_zero_line_modeEj)
    */lv0ldr/src/xdr/xdr.o(.text._ZN3xdr11row_addressEjj)
    */lv0ldr/src/xdr/xdr.o(.text._ZN3xdr4packEiPKtP7xdr_rec)
    */lv0ldr/src/xdr/xdr.o(.text._ZN3xdr10write_rowsEjPKt)
    */lv0ldr/src/xdr/xdr.o(.text._ZN3xdr14write_xdr_rowsEv)
    */lv0ldr/src/xdr/xdr.o(.text._ZN3xdr15write_tx_tablesEv)
    */lv0ldr/src/xdr/xdr.o(.text._ZN3xdr15write_rx_tablesEv)
    */lv0ldr/src/xdr/xdr.o(.text._ZN3xdrC2Ev)
    */lv0ldr/src/xdr/xdr.o(.text._ZN3xdrC1Ev)
    */lv0ldr/src/xdr/xdr.o(.text._ZN7be_mmio6read64Ej)
    */lv0ldr/src/xdr/xdr.o(.text._ZN7be_mmio14get_mic_timingEjt)
    */lv0ldr/src/xdr/xdr.o(.text._ZN3xdr4dumpEi)
    */lv0ldr/src/xdr/xdr.o(.text._ZN3xdr21check_channel_windowsEi)
    */lv0ldr/src/xdr/xdr.o(.text._ZN3xdr15add_rx_readingsEv)
    */lv0ldr/src/xdr/xdr.o(.text._ZN3xdr15add_tx_readingsEv)
    */lv0ldr/src/xdr/xdr.o(.text._ZN7be_mmio6poll64Ejjjjjj)
    */lv0ldr/src/xdr/xdr.o(.text._ZN3xdr9fill_hex2EPcj)
    */lv0ldr/src/xdr/xdr.o(.text._ZN3xdr9fill_dec2EPcj)
    */lv0ldr/src/xdr/xdr.o(.text._ZN3xdr20print_window_summaryEv)
    */lv0ldr/src/xdr/xdr.o(.text._ZN3xdr13check_windowsEv)
    */lv0ldr/src/xdr/xdr.o(.text._ZN3xdr20load_rows_to_devicesEv)
    */lv0ldr/src/xdr/xdr.o(.text._ZN3xdr10initializeEv)
    */lv0ldr/src/xdr/xdr_calib.o(.text._ZN3xdr16write_mic_configEv)
    */lv0ldr/src/xdr/xdr_calib.o(.text._ZN7be_mmio15poll_mic_timingEjtttj)
    */lv0ldr/src/xdr/xdr_calib.o(.text._ZN3xdr13init_xio_linkEv)
    */lv0ldr/src/xdr/xdr_calib.o(.text._ZN3xdr12init_devicesEv)
    */lv0ldr/src/xdr/xdr_calib.o(.text._ZN3xdr12calibrate_rxEv)
    */lv0ldr/src/xdr/xdr_calib.o(.text._ZN3xdr15store_zero_lineEj)
    */lv0ldr/src/xdr/xdr_calib.o(.text._ZN3xdr14run_mic_cmd_c0Ev)
    */lv0ldr/src/xdr/xdr_calib.o(.text._ZN3xdr12calibrate_txEv)
    */lv0ldr/src/xdr/xdr_calib.o(.text._ZN3xdr16read_ptcal_startEv)
    */lv0ldr/src/xdr/xdr_calib.o(.text._ZN3xdr20write_ptcal_settingsEv)
    */lv0ldr/src/xdr/xdr_calib.o(.text._ZN7be_mmio8delay_msEj)
    */lv0ldr/src/xdr/xdr_calib.o(.text._ZN3xdr12enable_ptcalEv)
    */lv0ldr/src/xdr/xdr_dump.o(.text._ZN3xdr8dump_xdrEv)
    */lv0ldr/src/xdr/xdr_dump.o(.text._ZN3xdr8dump_xioEv)
    */lv0ldr/src/xdr/xdr_dump.o(.text._ZN3xdr8dump_micEv)
    */lv0ldr/src/xdr/xdr_dump.o(.text._ZN3xdr9dump_regsEv)
    */lv0ldr/src/xdr/xdr_dump.o(.text._ZN3xdr16prepare_iow_dumpEv)
    */lv0ldr/src/xdr/xdr_serial.o(.text._Z10serial_bitPhh)
    */lv0ldr/src/xdr/xdr_serial.o(.text._Z11serial_bytePhh)
    */lv0ldr/src/xdr/xdr_serial.o(.text._ZN3xdr11serial_readEjthPt)
    */lv0ldr/src/io/iommu.o(.text._ZN13iommu_context18clear_iopt_entriesEyj)
    */lv0ldr/src/io/iommu.o(.text._ZN13iommu_context16clear_iost_entryEy)
    */lv0ldr/src/io/iommu.o(.text._ZN13iommu_context25get_iost_entry_io_addressEy)
    */lv0ldr/src/io/iommu.o(.text._ZN13iommu_context22invalidate4_iopt_cacheEyj)
    */lv0ldr/src/io/iommu.o(.text._ZN13iommu_context19allocate_iopt_entryEPyj)
    */lv0ldr/src/io/iommu.o(.text._ZN13iommu_context19allocate_iost_entryEPy)
    */lv0ldr/src/io/iommu.o(.text._ZN13iommu_context7disableEv)
    */lv0ldr/src/io/iommu.o(.text._ZN13iommu_context10initializeEyyjyj)
    */lv0ldr/src/io/iommu.o(.text._ZN13iommu_context21invalidate_iost_cacheEy)
    */lv0ldr/src/io/iommu.o(.text._ZN13iommu_context15free_io_addressEy)
    */lv0ldr/src/io/iommu.o(.text._ZN13iommu_context19allocate_io_addressEjyjjjjjj)
    */lv0ldr/src/io/iommu.o(.text._Z17get_iommu_contextv)
    */lv0ldr/src/flash/nand_flash_ctrl.o(.text._ZN15nand_flash_ctrl8set_baseEy)
    */lv0ldr/src/util/mmio_access.o(.text._Z6read16y)
    */lv0ldr/src/flash/nand_flash_ctrl.o(.text._ZN15nand_flash_ctrl10get_statusEv)
    */lv0ldr/src/flash/nand_flash_ctrl.o(.text._ZN15nand_flash_ctrl8get_intrEv)
    */lv0ldr/src/util/mmio_access.o(.text._Z7write16yt)
    */lv0ldr/src/flash/nand_flash_ctrl.o(.text._ZN15nand_flash_ctrl4idleEv)
    */lv0ldr/src/flash/nand_flash_ctrl.o(.text._ZN15nand_flash_ctrl17start_read_sectorEjtt)
    */lv0ldr/src/flash/nand_flash_ctrl.o(.text._ZN15nand_flash_ctrl10start_idleEv)
    */lv0ldr/src/flash/nand_flash_ctrl.o(.text._Z19get_nand_flash_ctrlv)
    *(.gnu.linkonce.t._Z8kick_dmayj)
    *(.gnu.linkonce.t._Z14get_dma_statusv)
    */lv0ldr/src/flash/nand_flash_transfer.o(.text._Z29set_nand_flash_ready_callbackPFbvE)
    */lv0ldr/src/flash/nand_flash_transfer.o(.text._ZN15nand_flash_ctrl16read_sectors_dmaEmjjPFbvE)
    */lv0ldr/src/flash/nand_flash_transfer.o(.text._ZN15nand_flash_ctrl15read_sector_dmaEmjj)
    */lv0ldr/src/util/delay.o(.text._Z17write_decrementerj)
    */lv0ldr/src/util/delay.o(.text._Z17start_decrementerj)
    */lv0ldr/src/util/delay.o(.text._Z15delay_dec_ticksi)
    */lv0ldr/src/util/delay.o(.text._Z8delay_msj)
    */lv0ldr/src/util/delay.o(.text._Z8delay_usj)
    */lv0ldr/src/util/delay.o(.text._Z8delay_nsj)
    */lv0ldr/src/console/uart.o(.text.strlen)
    */lv0ldr/src/console/uart.o(.text._ZN4uart4putcEl)
    */lv0ldr/src/console/uart.o(.text._ZN4uart4putsEPKc)
    */lv0ldr/src/console/uart.o(.text._ZN4uart4initEyiilbl)
    */lv0ldr/src/console/uart.o(.text._Z8get_uartv)
    */lv0ldr/src/console/uart.o(.text._Z17uart_console_putsPKc)
    */lv0ldr/src/flash/flash_probe.o(.text._Z11uart_printfPKcz)
    */lv0ldr/src/flash/flash_probe.o(.text._Z13syscon_printfPKcz)
    */lv0ldr/src/flash/flash_probe.o(.text._Z16probe_nand_flashy)
    */lv0ldr/src/platform/pio.o(.text._ZN3pio9configureEytt)
    */lv0ldr/src/platform/pio.o(.text._ZN3pio12write_fff500Et)
    */lv0ldr/src/platform/pio.o(.text._ZN3pio13reverse_bits8Eh)
    */lv0ldr/src/platform/pio.o(.text._ZN3pio17write_output_byteEh)
    */lv0ldr/src/platform/pio.o(.text._ZN3pio11read_fff504EPt)
    *(.gnu.linkonce.t._Z7get_piov)
    */lv0ldr/src/platform/pio.o(.text._ZN3pio25is_ss2_interrupt_assertedEv)
    */lv0ldr/src/platform/pio.o(.text._Z18poll_ss2_interruptv)
    */lv0ldr/src/io/sb_registers.o(.text._Z18sb_dx_write32_1f60yj)
    */lv0ldr/src/io/sb_registers.o(.text._Z18sb_dx_write32_1c70yj)
    */lv0ldr/src/io/sb_registers.o(.text._Z18sb_dx_write32_1c74yj)
    */lv0ldr/src/io/sb_registers.o(.text._Z6write8yh)
    */lv0ldr/src/io/sb_registers.o(.text._ZN9sb_device14write8_100000aEih)
    */lv0ldr/src/io/sb_registers.o(.text._ZN9sb_device14write8_100003aEh)
    */lv0ldr/src/io/init_sb_device.o(.text._ZN9sb_device10initializeEyb)
    */lv0ldr/src/io/get_sb_device.o(.text._Z13get_sb_devicev)
    */lv0ldr/src/io/systemio_dmac_dx.o(.text._ZN16systemio_dmac_dx9configureEyyyyy)
    */lv0ldr/src/util/mmio_access.o(.text._Z19copy_qwords_to_mmioyPcj)
    */lv0ldr/src/io/systemio_dmac_dx.o(.text._ZN16systemio_dmac_dx14get_dma_statusEv)
    */lv0ldr/src/io/systemio_dmac_dx.o(.text._ZN16systemio_dmac_dx14start_transferEyyj)
    */lv0ldr/src/io/systemio_dmac_dx.o(.text._ZN16systemio_dmac_dx8kick_dmaEyj)
    */lv0ldr/src/io/systemio_dmac_dx.o(.text._Z20get_systemio_dmac_dxv)
    */lv0ldr/src/io/systemio_dmac_px.o(.text._ZN16systemio_dmac_px9configureEyyyj)
    */lv0ldr/src/io/systemio_dmac_px.o(.text._ZN16systemio_dmac_px14get_dma_statusEv)
    */lv0ldr/src/io/systemio_dmac_px.o(.text._ZN16systemio_dmac_px26is_ebus_interrupt_assertedEv)
    */lv0ldr/src/io/systemio_dmac_px.o(.text._ZN16systemio_dmac_px8kick_dmaEyj)
    */lv0ldr/src/io/systemio_dmac_px.o(.text._Z20get_systemio_dmac_pxv)
    */lv0ldr/src/io/systemio_dmac_px.o(.text._Z19poll_ebus_interruptv)
    */lv0ldr/src/io/iopt.o(.text._Z20iopt_unpack_entry_v2yjP9iopt_desc)
    */lv0ldr/src/io/iopt.o(.text._Z18iopt_pack_entry_v2yjP9iopt_desc)
    */lv0ldr/src/io/iopt.o(.text._Z18iopt_pack_entry_v1yjP9iopt_desc)
    */lv0ldr/src/io/iopt.o(.text._ZN10iopt_codec10pack_entryEyjPv)
    */lv0ldr/src/io/iopt.o(.text._Z20iopt_unpack_entry_v1yjP9iopt_desc)
    */lv0ldr/src/io/iopt.o(.text._ZN10iopt_codec12unpack_entryEyjPv)
    */lv0ldr/src/syscon/syscon_xdr.o(.text._Z22syscon_read_xdr_configPv)
    */lv0ldr/src/syscon/syscon_xdr.o(.text._Z19syscon_set_xdr_railhh)
    */lv0ldr/src/syscon/syscon_xdr.o(.text._Z23syscon_write_xdr_configjj)
    */lv0ldr/src/syscon/syscon_xdr.o(.text._Z20syscon_read_config_2Pj)
    */lv0ldr/src/syscon/syscon_config.o(.text._Z32syscon_get_core_clock_multiplierPx)
    */lv0ldr/src/syscon/syscon_config.o(.text._Z22syscon_get_clock_valuePjhhb)
    */lv0ldr/src/syscon/syscon_config.o(.text._Z20syscon_get_ref_clockPjb)
    */lv0ldr/src/syscon/syscon_config.o(.text._Z20syscon_get_xdr_clockPjb)
    */lv0ldr/src/syscon/sc_console.o(.text._Z19syscon_write_stringPKc)
    */lv0ldr/src/syscon/syscon.o(.text._ZN6syscon11read_swbintEv)
    */lv0ldr/src/syscon/syscon.o(.text._ZN6syscon20get_protocol_versionEv)
    */lv0ldr/src/syscon/syscon.o(.text._ZN6syscon6set_f8Eh)
    */lv0ldr/src/syscon/syscon.o(.text._ZN6syscon16sc_calc_checksumEPhjPt)
    */lv0ldr/src/syscon/syscon.o(.text._ZN6syscon20sc_calc_checksum_negEPhjPt)
    */lv0ldr/src/syscon/syscon.o(.text._ZN6syscon18raise_sc_interruptEm)
    */lv0ldr/src/syscon/syscon.o(.text._ZN6syscon22get_swbint_status_ver1Ev)
    */lv0ldr/src/syscon/syscon.o(.text._ZN6syscon17get_swbint_statusEv)
    */lv0ldr/src/syscon/syscon.o(.text._ZN6syscon11wait_swbintEl)
    */lv0ldr/src/syscon/syscon.o(.text._ZN6syscon18read_cmpl_msg_ver1EPiPvjS0_P10sc_msg_ids)
    */lv0ldr/src/syscon/syscon.o(.text._ZN6syscon13read_cmpl_msgEPiPvjS0_P10sc_msg_ids)
    */lv0ldr/src/syscon/syscon.o(.text._ZN6syscon19write_init_msg_ver1ElPKvmP10sc_msg_idsb)
    */lv0ldr/src/syscon/syscon.o(.text._ZN6syscon14write_init_msgElPKvjP10sc_msg_ids)
    */lv0ldr/src/syscon/syscon.o(.text._ZN6syscon10initializeEyib)
    */lv0ldr/src/syscon/syscon.o(.text._ZN6syscon16send_and_receiveEjPKvjPvjPii)
    *(.gnu.linkonce.t._Z17get_syscon_devicev)
    */lv0ldr/src/syscon/syscon_power.o(.text._Z20syscon_get_wake_infoPhS_S_S_S_Pj)
    */lv0ldr/src/syscon/syscon_power.o(.text._Z26syscon_power_off_with_codeiii)
    */lv0ldr/src/syscon/syscon_power.o(.text._Z22syscon_set_wake_sourcej)
    */lv0ldr/src/storage/nv_storage.o(.text._Z26is_sc_nv_storage_supportedv)
    */lv0ldr/src/storage/nv_storage.o(.text._ZN10nv_storage4readEjjjPvj)
    */lv0ldr/src/storage/nv_storage.o(.text._Z13load_nv_entryj)
    */lv0ldr/src/storage/nv_storage.o(.text._ZN10nv_storage5writeEjjjPvj)
    */lv0ldr/src/syscon/sc_dev_access.o(.text._ZN13sc_dev_access5writeEjPKvj)
    */lv0ldr/src/syscon/sc_dev_access.o(.text._ZN13sc_dev_access4readEjPvj)
    */lv0ldr/src/syscon/sc_nv_storage.o(.text._ZN13sc_nv_storage12check_statusEh)
    */lv0ldr/src/syscon/sc_nv_storage.o(.text._ZN13sc_nv_storage5writeEjjjPKv)
    */lv0ldr/src/syscon/sc_nv_storage.o(.text._ZN13sc_nv_storage4readEjjjPvPj)
    */lv0ldr/src/log/log.o(.text._Z12log_dispatchiiPKcP13__va_list_tag)
    */lv0ldr/src/log/log.o(.text._Z11log_messagePKcz)
    */lv0ldr/src/log/log.o(.text._Z8log_infoPKcz)
    */lv0ldr/src/log/log.o(.text._Z9log_debugPKcz)
    */lv0ldr/src/log/log.o(.text._Z9log_errorPKcz)
    */lv0ldr/src/log/log.o(.text._Z15log_set_handleriPFlPKcE)
    */lv0ldr/src/log/log.o(.text._Z17log_set_thresholdi)
    */lv0ldr/src/log/log.o(.text._Z21log_set_final_handlerPFlvE)
    */lv0ldr/src/boot/exit.o(.text.exit)
    */lv0ldr/src/log/printf.o(.text._Z19lv0_vfprintf_enginePFilPlllEljPKhP13__va_list_tag)
    */lv0ldr/src/log/printf.o(.text._Z17snprintf_put_charPPcPjli)
    */lv0ldr/src/log/printf.o(.text._Z13lv0_vsnprintfPcmPKcP13__va_list_tag)
    */lv0ldr/crypto/aes_cbc_encrypt.o(.text)
    */lv0ldr/libgcc/divdi3.o(.text)
    */lv0ldr/libgcc/moddi3.o(.text)
    */lv0ldr/libgcc/udivdi3.o(.text)
    */lv0ldr/libgcc/umoddi3.o(.text)
    *(.text .text.* .gnu.linkonce.t.*)
  }

  .rodata :
  {
    */lv0ldr/src/boot/loader.o(.gnu.linkonce.r.*)
    */lv0ldr/src/boot/loader.o(.rodata .rodata.*)
    */lv0ldr/src/util/mmio_access.o(.rodata .rodata.*)
    */lv0ldr/src/auth/loader_auth.o(.rodata .rodata.*)
    */lv0ldr/src/platform/config_ring.o(.rodata .rodata.*)
    */lv0ldr/src/flash/ros_entry.o(.rodata .rodata.*)
    *(.gnu.linkonce.r._ZTV6cipher)
    *(.gnu.linkonce.r._ZTV17aes128_ctr_cipher)
    *(.gnu.linkonce.r._ZTV17aes256_cbc_cipher)
    *(.gnu.linkonce.r._ZTV17aes128_cbc_cipher)
    *(.gnu.linkonce.r._ZTV8verifier)
    *(.gnu.linkonce.r._ZTV14ecdsa_verifier)
    */lv0ldr/src/auth/authenticator.o(.rodata .rodata.*)
    */lv0ldr/src/auth/auth_segments.o(.rodata .rodata.*)
    */lv0ldr/src/dma/dma_queue.o(.rodata .rodata.*)
    */lv0ldr/src/dma/dma_buffer.o(.gnu.linkonce.r.*)
    */lv0ldr/src/dma/dma_buffer.o(.rodata .rodata.*)
    */lv0ldr/src/dma/dma_buffer_io.o(.gnu.linkonce.r.*)
    */lv0ldr/src/dma/dma_buffer_io.o(.rodata .rodata.*)
    */lv0ldr/crypto/aes_modes.o(.rodata .rodata.*)
    */lv0ldr/crypto/aes.o(.rodata .rodata.*)
    */lv0ldr/crypto/sha1.o(.rodata .rodata.*)
    */lv0ldr/crypto/sha1_transform.o(.rodata .rodata.*)
    */lv0ldr/crypto/bn.o(.rodata .rodata.*)
    */lv0ldr/crypto/ec_curve_table.o(.rodata .rodata.*)
    */lv0ldr/src/xdr/xdr_config.o(.rodata .rodata.*)
    */lv0ldr/src/boot/loader_unit.o(.rodata .rodata.*)
    */lv0ldr/src/boot/memory_config.o(.rodata .rodata.*)
    */lv0ldr/src/boot/memory_diag.o(.rodata .rodata.*)
    */lv0ldr/src/platform/be_mmio.o(.rodata.be_mmio_base)
    */lv0ldr/src/platform/be_mmio.o(.rodata.mic_timing_reg)
    */lv0ldr/src/platform/be_mmio.o(.rodata.mic_timing_b_reg)
    */lv0ldr/src/platform/be_mmio.o(.rodata .rodata.*)
    */lv0ldr/src/xdr/xdr.o(.rodata .rodata.*)
    */lv0ldr/src/xdr/xdr_calib.o(.rodata.mic_read_reg)
    */lv0ldr/src/xdr/xdr_calib.o(.rodata.xio_pll_set)
    */lv0ldr/src/xdr/xdr_calib.o(.rodata .rodata.*)
    */lv0ldr/src/xdr/xdr_dump.o(.rodata .rodata.*)
    */lv0ldr/src/io/iommu.o(.rodata .rodata.*)
    */lv0ldr/src/flash/nand_flash_ctrl.o(.rodata .rodata.*)
    */lv0ldr/src/flash/nand_flash_transfer.o(.rodata .rodata.*)
    */lv0ldr/src/console/uart.o(.rodata .rodata.*)
    */lv0ldr/src/flash/flash_probe.o(.rodata .rodata.*)
    */lv0ldr/src/platform/pio.o(.rodata .rodata.*)
    */lv0ldr/src/io/sb_registers.o(.rodata .rodata.*)
    */lv0ldr/src/io/init_sb_device.o(.rodata .rodata.*)
    */lv0ldr/src/io/systemio_dmac_dx.o(.rodata.cst16)
    */lv0ldr/src/io/systemio_dmac_dx.o(.rodata .rodata.*)
    */lv0ldr/src/io/systemio_dmac_px.o(.rodata .rodata.*)
    */lv0ldr/src/io/iopt.o(.rodata .rodata.*)
    */lv0ldr/src/syscon/syscon.o(.rodata .rodata.*)
    */lv0ldr/src/storage/nv_storage.o(.rodata .rodata.*)
    */lv0ldr/src/syscon/sc_nv_storage.o(.rodata .rodata.*)
    */lv0ldr/src/log/printf.o(.rodata .rodata.*)
    */lv0ldr/libgcc/divdi3.o(.rodata .rodata.*)
    */lv0ldr/libgcc/moddi3.o(.rodata .rodata.*)
    */lv0ldr/src/util/shuffle_table.o(.rodata .rodata.*)
    *(.rodata .rodata.* .gnu.linkonce.r.*)
  }

  . = ALIGN(0x80);
  .data :
  {
    */lv0ldr/src/dma/dma.o(.data .data.*)
    */lv0ldr/src/auth/loader_auth.o(.data .data.*)
    */lv0ldr/src/platform/config_ring.o(.data .data.*)
    */lv0ldr/src/boot/loader_unit.o(.data.g_dma_io_addr)
    */lv0ldr/src/boot/loader_unit.o(.data.g_first_spu_priv1_20)
    */lv0ldr/src/boot/loader_unit.o(.data.g_ss2_work_offset)
    */lv0ldr/src/boot/memory_diag.o(.data.g_read_buffers)
    */lv0ldr/src/boot/memory_diag.o(.data.g_write_buffer)
    *(.data .data.* .gnu.linkonce.d.*)
  }
  .ctors : { KEEP(*(.ctors)) __CTOR_END__ = .; }
  .dtors : { KEEP(*(.dtors)) }
  .bss :
  {
    */lv0ldr/src/auth/loader_auth.o(.bss .bss.*)
    */lv0ldr/src/auth/elf_reader.o(.bss .bss.*)
    */lv0ldr/src/auth/auth_buffers.o(.bss .bss.*)
    */lv0ldr/src/auth/cipher_aes256_cbc.o(.bss .bss.*)
    */lv0ldr/src/auth/cipher_aes128_cbc.o(.bss .bss.*)
    */lv0ldr/src/auth/cipher_aes128_ctr.o(.bss .bss.*)
    */lv0ldr/src/auth/verifier_ecdsa.o(.bss .bss.*)
    */lv0ldr/src/auth/hmac_digest.o(.bss .bss.*)
    */lv0ldr/src/dma/dma_buffer.o(.bss .bss.*)
    */lv0ldr/src/boot/loader_unit.o(.bss .bss.*)
    */lv0ldr/src/xdr/xdr_calib.o(.bss .bss.*)
    */lv0ldr/src/io/iommu.o(.bss .bss.*)
    */lv0ldr/src/flash/nand_flash_ctrl.o(.bss .bss.*)
    */lv0ldr/src/flash/nand_flash_transfer.o(.bss .bss.*)
    */lv0ldr/src/console/uart.o(.bss .bss.*)
    */lv0ldr/src/platform/pio.o(.bss .bss.* .gnu.linkonce.b.*)
    */lv0ldr/src/io/get_sb_device.o(.bss .bss.*)
    */lv0ldr/src/io/systemio_dmac_dx.o(.bss .bss.*)
    */lv0ldr/src/io/systemio_dmac_px.o(.bss .bss.*)
    */lv0ldr/src/syscon/sc_console.o(.bss .bss.*)
    */lv0ldr/src/syscon/syscon.o(.bss.g_sc_msg_buffer)
    */lv0ldr/src/syscon/syscon.o(.bss .bss.* .gnu.linkonce.b.*)
    *(.bss .bss.* .gnu.linkonce.b.*)
    *(COMMON)
  }

  /DISCARD/ : { *(.dropped) *(.comment) *(.note*) *(.eh_frame) }
}

/* lv0ldr2.ld -- lv0ldr.2's link: its decrypted body at 0x400-0x303B0 as
 * the image has it. Every function's section at its address in the
 * image's order (one line a section), then every data section at the
 * image's address of its symbol, in the image's order; the merged 16-byte
 * constants and messages (.rodata.cst16, .rodata.str1.16) where the first
 * one only their unit's code refers to is, the linker keeping each where
 * it first appears. The memory test's SPU program (spu_memtest.S) comes
 * last in .data; the functions the link drops go nowhere (.dropped). */

ENTRY(_start)

SECTIONS
{
  . = 0x400;

  .text :
  {
    */isoldr/src/crt0.o(.text)
    */lv0ldr2/src/boot/main.o(.text.main)
    */lv0ldr2/src/boot/loader.o(.text._ZN6loaderC1Ev)
    */lv0ldr2/src/boot/loader.o(.text._ZN6loaderC2Ev)
    */lv0ldr2/src/boot/loader.o(.text._ZN6loader12print_bannerEv)
    */lv0ldr2/src/boot/loader.o(.text._ZN6loader9find_fileEyPKcPyS2_)
    */lv0ldr2/src/dma/dma.o(.text._Z8dma_waitv)
    */lv0ldr2/src/dma/dma.o(.text._Z21copy_qwords_from_mmioyPcj)
    */lv0ldr2/src/boot/loader.o(.text._ZN6loader12find_lv0_rosEyPyS0_)
    */lv0ldr2/src/boot/loader.o(.text._ZN6loader14find_lv0_flashEyPyS0_)
    */lv0ldr2/src/boot/loader.o(.text._ZN6loader8find_lv0EPyS0_)
    */lv0ldr2/src/boot/loader.o(.text._ZN6loader8finalizeEbl)
    */lv0ldr2/src/boot/loader.o(.text._ZN6loader3runEv)
    */lv0ldr2/src/auth/loader_auth.o(.text._Z41__static_initialization_and_destruction_0ii)
    */lv0ldr2/src/auth/loader_auth.o(.text._GLOBAL__D_lv0_header_key)
    */lv0ldr2/src/auth/loader_auth.o(.text._GLOBAL__I_lv0_header_key)
    */lv0ldr2/src/auth/loader_auth.o(.text._ZN11loader_base17check_config_ringEv)
    */lv0ldr2/src/auth/loader_auth.o(.text._ZN6loader4haltEv)
    */lv0ldr2/src/util/mmio_access.o(.text._Z7write32yj)
    */lv0ldr2/src/auth/loader_auth.o(.text._ZN6loader7handoffEv)
    */lv0ldr2/src/auth/loader_auth.o(.text._ZN6loader5startEv)
    *(.text._ZN17tagged_dma_bufferD1Ev)
    */lv0ldr2/src/auth/loader_auth.o(.text._ZN6loader8load_lv0Eyy)
    */lv0ldr2/src/platform/config_ring.o(.text._ZN11config_ring8cmp_bitsEPKhS1_tti)
    */lv0ldr2/src/util/mmio_access.o(.text._Z6read64y)
    */lv0ldr2/src/platform/config_ring.o(.text._Z10get_spu_vry)
    *(.text._Z6read32y)
    */lv0ldr2/src/platform/config_ring.o(.text._Z14is_spu_enabledy)
    */lv0ldr2/src/platform/config_ring.o(.text._Z13get_first_spuv)
    */lv0ldr2/src/platform/config_ring.o(.text._Z16get_first_spu_vrv)
    */lv0ldr2/src/platform/config_ring.o(.text._ZN11config_ring6verifyEv)
    */lv0ldr2/src/flash/ros_entry.o(.text._Z14ros_find_entryyjPKcP13ros_toc_entry)
    */lv0ldr2/src/flash/ros_header.o(.text._Z15ros_read_headeryP14ros_toc_header)
    */lv2ldr/src/auth_checks.o(.text._ZN13authenticator12get_app_infoEP13auth_app_info)
    */lv0ldr2/src/auth/authenticator.o(.text._ZN9elf_imageC1Ev)
    */lv0ldr2/src/auth/authenticator.o(.text._ZN9elf_image4loadEPKv)
    *(.text._ZN6cipher6vslot6EPKv)
    *(.text._ZN6cipher6vslot7EPv)
    */lv0ldr2/src/auth/authenticator.o(.text._ZN13authenticator10set_offsetEy)
    */lv0ldr2/src/auth/authenticator.o(.text._ZN13authenticator14check_app_infoEPK13auth_app_infoj)
    *(.text._ZN6cipherD0Ev)
    *(.text._ZN6cipherD1Ev)
    *(.text._ZN6cipherD2Ev)
    */isoldr/src/cipher_aes128_ctr.o(.text._ZN17aes128_ctr_cipherD0Ev)
    */isoldr/src/cipher_aes128_ctr.o(.text._ZN17aes128_ctr_cipherD1Ev)
    */isoldr/src/cipher_aes256_cbc.o(.text._ZN17aes256_cbc_cipherD0Ev)
    *(.text._ZN17aes256_cbc_cipherD1Ev)
    *(.text._ZN8verifierD0Ev)
    *(.text._ZN8verifierD1Ev)
    *(.text._ZN8verifierD2Ev)
    */isoldr/src/verifier_ecdsa.o(.text._ZN14ecdsa_verifierD0Ev)
    *(.text._ZN14ecdsa_verifierD1Ev)
    */lv0ldr2/src/auth/authenticator.o(.text._ZN13authenticator9check_appEP9sce_imagej)
    */lv0ldr2/src/auth/authenticator.o(.text._ZN13authenticator11load_headerEjPKhS1_S1_PKjPP10dma_bufferj)
    */lv0ldr2/src/auth/authenticator.o(.text._ZN13authenticator11clear_partsEv)
    */lv0ldr2/src/auth/authenticator.o(.text._ZN13authenticatorC1Ev)
    */lv0ldr2/src/auth/authenticator.o(.text._ZN13authenticatorC2Ev)
    */lv0ldr2/src/auth/authenticator.o(.text._ZN13authenticatorD1Ev)
    */lv0ldr2/src/auth/authenticator.o(.text._ZN13authenticatorD2Ev)
    */lv0ldr2/src/auth/authenticator.o(.text._ZN13authenticator19read_program_headerEjP10Elf64_Phdr)
    */lv0ldr2/src/auth/authenticator.o(.text._ZN13authenticator15read_elf_headerEP10Elf64_Ehdr)
    */lv1ldr/src/auth_buffers.o(.text._ZN10auth_block4loadEPK10auth_entryy)
    */lv1ldr/src/auth_buffers.o(.text._ZN10auth_blockC1Ev)
    */lv1ldr/src/auth_buffers.o(.text._ZN10auth_blockC2Ev)
    */lv1ldr/src/auth_buffers.o(.text._ZN11header_data5clearEv)
    */appldr/src/auth_app.o(.text._ZN9auth_tail5resetEv)
    */lv1ldr/src/auth_buffers.o(.text._ZN9auth_tailC1Ev)
    */lv1ldr/src/auth_buffers.o(.text._ZN9auth_tailC2Ev)
    */isoldr/src/auth_segments.o(.text._ZN13authenticator12load_segmentEjjyPP10dma_bufferiS2_i)
    */lv1ldr/src/auth_transfer.o(.text._ZN13authenticator15transfer_storedEv)
    *(.text._ZN17aes256_cbc_cipherC1Ev)
    */isoldr/src/cipher_aes256_cbc.o(.text._Z41__static_initialization_and_destruction_0ii)
    */isoldr/src/cipher_aes256_cbc.o(.text._GLOBAL__D_g_aes256_cbc)
    */isoldr/src/cipher_aes256_cbc.o(.text._GLOBAL__I_g_aes256_cbc)
    */isoldr/src/cipher_aes256_cbc.o(.text._ZN17aes256_cbc_cipher7decryptEPKviPv)
    */isoldr/src/cipher_aes256_cbc.o(.text._ZN17aes256_cbc_cipher7set_keyEPKhS1_)
    */isoldr/src/cipher_aes128_ctr.o(.text._ZN17aes128_ctr_cipherC1Ev)
    */isoldr/src/cipher_aes128_ctr.o(.text._Z41__static_initialization_and_destruction_0ii)
    */isoldr/src/cipher_aes128_ctr.o(.text._GLOBAL__D_g_aes128_ctr)
    */isoldr/src/cipher_aes128_ctr.o(.text._GLOBAL__I_g_aes128_ctr)
    */isoldr/src/cipher_aes128_ctr.o(.text._ZN17aes128_ctr_cipher7decryptEPKviPv)
    */isoldr/src/cipher_aes128_ctr.o(.text._ZN17aes128_ctr_cipher7set_keyEPKhS1_)
    */lv1ldr/src/auth_buffers.o(.text._ZN13authenticator7prependEPK10dma_bufferj)
    *(.text._Z12bytes_differPKhS0_i)
    */lv1ldr/src/auth_buffers.o(.text._ZN13authenticator17check_part_digestEPK12auth_section)
    */lv1ldr/src/auth_buffers.o(.text._ZN9auth_sink6appendEPKU8__vectorhS2_)
    */lv1ldr/src/auth_buffers.o(.text._ZN13authenticator10read_partsEv)
    */lv1ldr/src/auth_buffers.o(.text._ZN13authenticator9save_tailEPK10dma_buffer)
    */lv1ldr/src/auth_buffers.o(.text._ZN13authenticator12restore_tailEPK10dma_buffer)
    */isoldr/src/verifier_ecdsa.o(.text._ZN14ecdsa_verifier6verifyEPKhiS1_)
    */isoldr/src/verifier_ecdsa.o(.text._ZN14ecdsa_verifierC1EPKhj)
    */isoldr/src/verifier_ecdsa.o(.text._ZN14ecdsa_verifierC2EPKhj)
    */lv1ldr/src/auth_buffers.o(.text._ZN13authenticator12find_sectionEjjP12auth_section)
    */lv1ldr/src/elf_reader.o(.text._ZN9elf_image10get_headerEP10Elf64_Ehdr)
    */lv1ldr/src/elf_reader.o(.text._ZN9elf_image18get_program_headerEjP10Elf64_Phdr)
    */lv1ldr/src/auth_buffers.o(.text._ZN10auth_state4loadEPK10auth_entryy)
    */lv1ldr/src/auth_buffers.o(.text._ZN10auth_stateC1Ev)
    */lv1ldr/src/auth_buffers.o(.text._ZN10auth_stateC2Ev)
    */isoldr/src/hmac_digest.o(.text._ZN11hmac_digestC1Ev)
    */isoldr/src/hmac_digest.o(.text._ZN11hmac_digestC2Ev)
    */isoldr/src/hmac_digest.o(.text._Z41__static_initialization_and_destruction_0ii)
    */isoldr/src/hmac_digest.o(.text._GLOBAL__I_g_hmac)
    */isoldr/src/hmac_digest.o(.text._GLOBAL__D_g_hmac)
    */isoldr/src/hmac_digest.o(.text._ZN11hmac_digest6updateEPKhi)
    */isoldr/src/hmac_digest.o(.text._ZN11hmac_digest5finalEPh)
    */isoldr/src/hmac_digest.o(.text._ZN11hmac_digest4initEPKhj)
    */isoldr/src/dma_queue.o(.text._ZN9dma_queue12enqueue_readEP10dma_buffer)
    */isoldr/src/dma_queue.o(.text._ZN9dma_queue7dequeueEPP10dma_bufferP9list_nodeMS0_FbvE)
    */isoldr/src/dma_queue.o(.text._ZN9dma_queue12dequeue_readEPP10dma_buffer)
    */isoldr/src/dma_queue.o(.text._ZN9dma_queue5drainEP9list_nodeM10dma_bufferFbvE)
    */isoldr/src/dma_queue.o(.text._ZN9dma_queue5closeEv)
    */isoldr/src/dma_queue.o(.text._ZN9dma_queueC1Ev)
    */isoldr/src/dma_queue.o(.text._ZN9dma_queueC2Ev)
    */isoldr/src/dma_queue.o(.text._ZN9dma_queue11add_writtenEP10dma_buffer)
    */isoldr/src/dma_queue.o(.text._ZN9dma_queue13enqueue_writeEP10dma_buffer)
    */isoldr/src/dma_queue.o(.text._ZN9dma_queue13dequeue_writeEPP10dma_buffer)
    */isoldr/src/dma_queue.o(.text._ZN9dma_queue4openEyjyj)
    */isoldr/src/dma_buffer.o(.text._ZN10dma_buffer10set_bufferEjj)
    *(.text._ZN10dma_bufferD0Ev)
    *(.text._ZN10dma_bufferD1Ev)
    *(.text._ZN10dma_bufferD2Ev)
    */isoldr/src/dma_buffer.o(.text._ZN10dma_bufferC1Ev)
    */isoldr/src/dma_buffer.o(.text._ZN10dma_bufferC2Ev)
    */isoldr/src/dma_buffer.o(.text._ZN17tagged_dma_buffer9max_chunkEj)
    */isoldr/src/dma_buffer_io.o(.text._ZN17tagged_dma_bufferD0Ev)
    */isoldr/src/dma_buffer.o(.text._ZN7dma_mfcC1Ev)
    */isoldr/src/dma_buffer.o(.text._Z41__static_initialization_and_destruction_0ii)
    */isoldr/src/dma_buffer.o(.text._GLOBAL__I__ZN10dma_bufferC2Ev)
    */isoldr/src/dma_buffer.o(.text._ZN17tagged_dma_buffer8transferEyyjj)
    */isoldr/src/dma_buffer.o(.text._ZN17tagged_dma_buffer8put_doneEv)
    */isoldr/src/dma_buffer.o(.text._ZN17tagged_dma_buffer8get_doneEv)
    */isoldr/src/dma_buffer.o(.text._ZN17tagged_dma_bufferC1Ej)
    */isoldr/src/dma_buffer.o(.text._ZN17tagged_dma_bufferC2Ej)
    */isoldr/src/dma_buffer_io.o(.text._ZN17tagged_dma_buffer3putEyjPj)
    */isoldr/src/dma_buffer_io.o(.text._ZN17tagged_dma_buffer3getEyjPj)
    */lv0ldr/crypto/aes_modes.o(.text)
    */lv0ldr/crypto/sha1_digest.o(.text)
    */lv0ldr/crypto/hmac_sha1.o(.text)
    */lv0ldr/crypto/aes_set_encrypt_key.o(.text)
    */lv0ldr/crypto/aes_set_decrypt_key.o(.text)
    */lv0ldr/crypto/aes_encrypt_block.o(.text)
    */lv0ldr/crypto/aes_encrypt8.o(.text)
    */lv0ldr/crypto/aes_decrypt_block.o(.text)
    */lv0ldr/crypto/aes_decrypt8.o(.text)
    */lv0ldr/crypto/sha1.o(.text)
    */lv0ldr/crypto/sha1_transform.o(.text)
    */lv0ldr/crypto/ecdsa_id.o(.text)
    */lv0ldr/crypto/ec_curves.o(.text)
    */isoldr/crypto/ecdsa.o(.text)
    */lv0ldr/crypto/ec.o(.text)
    */lv0ldr/crypto/ec_mul2.o(.text)
    */lv0ldr/crypto/bn_core.o(.text)
    */lv0ldr/crypto/bn_in_range.o(.text)
    */lv0ldr/crypto/ec_curve_valid.o(.text)
    */lv0ldr/crypto/bn_from_bytes_not.o(.text)
    */isoldr/src/mfc.o(.text._ZN8mfc_baseC1Ev)
    */isoldr/src/mfc.o(.text._ZN8mfc_baseC2Ev)
    */isoldr/src/mfc.o(.text._Z9mfc_issuejyjjjj)
    */isoldr/src/mfc.o(.text._Z12mfc_tag_donej)
    */lv0ldr2/src/util/cxx_runtime.o(.text._ZdlPv)
    */lv0ldr2/src/util/cxx_runtime.o(.text.__cxa_pure_virtual)
    */lv1ldr/src/auth_header.o(.text._ZN9sce_image12get_sectionsEv)
    */lv1ldr/src/auth_header.o(.text._ZN9sce_image17get_section_countEPj)
    */lv1ldr/src/auth_header.o(.text._ZN9sce_image13get_key_countEPj)
    */lv1ldr/src/auth_header.o(.text._ZN9sce_image14get_ext_headerEPjS0_)
    */lv0ldr2/src/auth/auth_check.o(.text._Z16check_sce_headerPKU8__vectorhPKvtj)
    */lv0ldr2/src/auth/auth_check.o(.text._Z17check_meta_headerPKU8__vectorhPK9auth_metaj)
    */lv0ldr2/src/auth/auth_check.o(.text._Z14check_sectionsP9sce_image)
    */lv0ldr2/src/auth/auth_check.o(.text._Z18check_control_infoPK12auth_controly)
    */lv0ldr2/src/auth/auth_check.o(.text._Z16check_ext_headerP9sce_image)
    */lv0ldr2/src/auth/auth_check.o(.text._ZN9sce_image12get_app_infoEPj)
    */lv0ldr2/src/boot/loader_unit.o(.text._Z12post_code_30v)
    */lv0ldr2/src/boot/loader_unit.o(.text._Z12post_code_08v)
    */lv0ldr2/src/boot/loader_unit.o(.text._Z12post_code_07bb)
    */lv0ldr2/src/boot/loader_unit.o(.text._Z12post_code_06v)
    */lv0ldr2/src/boot/loader_unit.o(.text._Z12post_code_05v)
    */lv0ldr2/src/boot/loader_unit.o(.text._Z12post_code_03v)
    */lv0ldr2/src/boot/loader_unit.o(.text._Z12post_code_02v)
    */lv0ldr2/src/boot/loader_unit.o(.text._Z12post_code_01v)
    */lv0ldr2/src/boot/loader_unit.o(.text._Z12post_code_aav)
    */lv0ldr2/src/boot/loader_unit.o(.text._Z18post_lv0_not_foundv)
    */lv0ldr2/src/boot/loader_unit.o(.text._Z18post_lv0_auth_failv)
    */lv0ldr2/src/boot/loader_unit.o(.text._ZN11loader_base5printEPKc)
    */lv0ldr2/src/boot/loader_unit.o(.text._Z16set_eeprom_48c0eh)
    */lv0ldr2/src/boot/loader_unit.o(.text._Z16set_eeprom_48c0dh)
    */lv0ldr2/src/boot/loader_unit.o(.text._Z23set_eeprom_bootrom_diagh)
    */lv0ldr2/src/boot/loader_unit.o(.text._Z24write_eeprom_nv1_u32_at8j)
    */lv0ldr2/src/boot/loader_unit.o(.text._Z24write_eeprom_nv1_u32_at4j)
    */lv0ldr2/src/boot/loader_unit.o(.text._Z18handle_fatal_errorj)
    */lv0ldr2/src/boot/loader_unit.o(.text._Z28get_eeprom_os_bank_indicatorPh)
    */lv0ldr2/src/boot/loader_unit.o(.text._ZN11loader_base21get_os_bank_indicatorEv)
    */lv0ldr2/src/boot/loader_unit.o(.text._Z30get_eeprom_bootrom_trace_levelPh)
    */lv0ldr2/src/boot/loader_unit.o(.text._Z16get_eeprom_48c0ePh)
    */lv0ldr2/src/boot/loader_unit.o(.text._Z16get_eeprom_48c0dPh)
    */lv0ldr2/src/boot/loader_unit.o(.text._Z23get_eeprom_bootrom_diagPh)
    */lv0ldr2/src/boot/loader_unit.o(.text._Z16get_bootrom_diagPhS_)
    */lv0ldr2/src/boot/loader_unit.o(.text._Z26get_eeprom_boot_fir_configPh)
    */lv0ldr2/src/boot/loader_unit.o(.text._Z19get_boot_fir_configv)
    */lv0ldr2/src/boot/loader_unit.o(.text._Z28get_eeprom_select_net_devicePh)
    */lv0ldr2/src/boot/loader_unit.o(.text._Z21get_debug_device_namev)
    */lv0ldr2/src/boot/loader_unit.o(.text._Z14get_sc_versionhPt)
    */lv0ldr2/src/boot/loader_unit.o(.text._Z27set_livelock_detection_modei)
    */lv0ldr2/src/boot/loader_unit.o(.text._Z24setup_livelock_detectionv)
    */lv0ldr2/src/boot/loader_unit.o(.text._Z16is_config_2_zerov)
    */lv0ldr2/src/boot/loader_unit.o(.text._Z23map_flash_format_windowyj)
    */lv0ldr2/src/boot/loader_unit.o(.text._Z22release_dma_io_addressv)
    */lv0ldr2/src/boot/loader_unit.o(.text._Z14write32_maskedyjj)
    *(.text._Z15is_sb_product_2v)
    *(.text._Z16is_sb_product_dxv)
    */lv0ldr2/src/boot/loader_unit.o(.text._Z18sb_dx_write32_1c34yj)
    */lv0ldr2/src/boot/loader_unit.o(.text._Z18sb_dx_write32_1c30yj)
    */lv0ldr2/src/boot/loader_unit.o(.text._Z19init_nand_flash_dmayyy)
    */lv0ldr2/src/boot/loader_unit.o(.text._Z19configure_sb_errorsb)
    *(.text._Z7write64yy)
    */lv0ldr2/src/boot/loader_unit.o(.text._Z22get_first_spu_priv1_20v)
    */lv0ldr2/src/boot/loader_unit.o(.text._Z19configure_be_errorsbb)
    */lv0ldr2/src/boot/loader_unit.o(.text._Z20get_boot_memory_typev)
    */lv0ldr2/src/boot/loader_unit.o(.text._Z23is_boot_memory_type_norv)
    */lv0ldr2/src/boot/loader_unit.o(.text._Z24is_boot_memory_type_nandv)
    */lv0ldr2/src/boot/loader_unit.o(.text._ZN11loader_base16get_flash_layoutEv)
    */lv0ldr2/src/boot/loader_unit.o(.text._ZN11loader_base18get_flash_rom_baseEv)
    */lv0ldr2/src/boot/loader_unit.o(.text._ZN11loader_base19is_sc_protocol_ver1Ev)
    */lv0ldr2/src/boot/loader_unit.o(.text._ZN11loader_base19copy_to_main_memoryEyj)
    */lv0ldr2/src/boot/loader_unit.o(.text._ZN11loader_base8finalizeEbl)
    */lv0ldr2/src/xdr/xdr.o(.text._ZN3xdr4infoEPKc)
    */lv0ldr2/src/xdr/xdr.o(.text._ZN3xdr5errorEPKc)
    */lv0ldr2/src/boot/loader_unit.o(.text._ZN3xdr10set_configEPK10xdr_config)
    */lv0ldr2/src/boot/loader_unit.o(.text._ZN11loader_base11init_memoryEv)
    */lv0ldr2/src/boot/loader_unit.o(.text._ZN11loader_base10initializeEv)
    */lv0ldr2/src/boot/sc_config_info.o(.text._ZN14sc_config_info3xdr10initializeEv)
    */lv0ldr2/src/boot/sc_config_info.o(.text._ZN14sc_config_info3xdr32identify_cbe_version_from_spu_vrEPjS1_)
    */lv0ldr2/src/boot/sc_config_info.o(.text._ZN14sc_config_info3xdr34is_waking_from_suspend_to_ram_modeEPh)
    */lv0ldr2/src/boot/sc_config_info.o(.text._ZN14sc_config_info3xdr12query_configEP10xdr_config)
    */lv0ldr2/src/boot/memory_diag.o(.text._Z17spe_priv1_write64yy)
    */lv0ldr2/src/boot/memory_diag.o(.text._Z13spu_write_npcyj)
    */lv0ldr2/src/boot/memory_diag.o(.text._Z7spu_runy)
    */lv0ldr2/src/boot/memory_diag.o(.text._Z15get_memory_sizev)
    */lv0ldr2/src/boot/memory_diag.o(.text._Z15spu_read_statusy)
    *(.text._Z19copy_qwords_to_mmioyPcj)
    */lv0ldr2/src/boot/memory_diag.o(.text._Z11memory_diagyjyh)
    */lv0ldr2/src/xdr/xdr.o(.text._ZN3xdr9fill_hex2EPcj)
    */lv0ldr2/src/xdr/xdr.o(.text._ZN3xdr9fill_dec2EPcj)
    */lv0ldr2/src/xdr/xdr.o(.text._ZN3xdr10fill_starsEPci)
    */lv0ldr2/src/xdr/xdr.o(.text._ZN3xdr9load_rowsEPt)
    */lv0ldr2/src/xdr/xdr.o(.text._ZN3xdr8bank_mapEij)
    */lv0ldr2/src/xdr/xdr.o(.text._ZN3xdr6timingEiii)
    */lv0ldr2/src/xdr/xdr.o(.text._ZN3xdr7permuteEt)
    */lv0ldr2/src/xdr/xdr.o(.text._ZN3xdr11row_addressEjj)
    */lv0ldr2/src/xdr/xdr.o(.text._ZN3xdr4packEiPKtP7xdr_rec)
    */lv0ldr2/src/platform/be_mmio.o(.text._ZN7be_mmio7write64Ejjj)
    */lv0ldr2/src/xdr/xdr.o(.text._ZN3xdr20store_zero_line_modeEj)
    */lv0ldr2/src/xdr/xdr.o(.text._ZN3xdr16enable_scrubbingEv)
    */lv0ldr2/src/platform/be_mmio.o(.text._ZN7be_mmio16set_mic_timing_bEjjt)
    */lv0ldr2/src/platform/be_mmio.o(.text._ZN7be_mmio14set_mic_timingEjtt)
    */lv0ldr2/src/xdr/xdr.o(.text._ZN3xdr15write_rx_tablesEv)
    */lv0ldr2/src/xdr/xdr.o(.text._ZN3xdr15write_tx_tablesEv)
    */lv0ldr2/src/xdr/xdr.o(.text._ZN7be_mmio6read64Ej)
    */lv0ldr2/src/xdr/xdr.o(.text._ZN7be_mmio14get_mic_timingEjt)
    */lv0ldr2/src/xdr/xdr.o(.text._ZN3xdr4dumpEi)
    */lv0ldr2/src/xdr/xdr.o(.text._ZN3xdr21check_channel_windowsEi)
    */lv0ldr2/src/xdr/xdr.o(.text._ZN3xdr15add_rx_readingsEv)
    */lv0ldr2/src/xdr/xdr.o(.text._ZN3xdr15add_tx_readingsEv)
    */lv0ldr2/src/xdr/xdr.o(.text._ZN3xdr20print_window_summaryEv)
    */lv0ldr2/src/xdr/xdr.o(.text._ZN3xdr13check_windowsEv)
    */lv0ldr2/src/xdr/xdr.o(.text._ZN3xdr15validate_configEv)
    */lv0ldr2/src/xdr/xdr.o(.text._ZN3xdr5beginEv)
    */lv0ldr2/src/xdr/xdr.o(.text._ZN3xdr13wake_from_strEv)
    */lv0ldr2/src/platform/be_mmio.o(.text._ZN7be_mmio8delay_usEj)
    */lv0ldr2/src/xdr/xdr.o(.text._ZN7be_mmio6poll64Ejjjjjj)
    */lv0ldr2/src/xdr/xdr.o(.text._ZN3xdr20load_rows_to_devicesEv)
    */lv0ldr2/src/platform/be_mmio.o(.text._ZN7be_mmio8delay_nsEj)
    */lv0ldr2/src/xdr/xdr.o(.text._ZN3xdr10write_rowsEjPKt)
    */lv0ldr2/src/xdr/xdr.o(.text._ZN3xdr14write_xdr_rowsEv)
    */lv0ldr2/src/xdr/xdr.o(.text._ZN3xdr10initializeEv)
    */lv0ldr2/src/xdr/xdr.o(.text._ZN3xdrC1Ev)
    */lv0ldr2/src/xdr/xdr.o(.text._ZN3xdrC2Ev)
    */lv0ldr2/src/xdr/xdr_calib.o(.text._ZN3xdr16write_mic_configEv)
    */lv0ldr2/src/xdr/xdr_calib.o(.text._ZN7be_mmio15poll_mic_timingEjtttj)
    */lv0ldr2/src/xdr/xdr_calib.o(.text._ZN3xdr13init_xio_linkEv)
    */lv0ldr2/src/xdr/xdr_calib.o(.text._ZN3xdr12init_devicesEv)
    */lv0ldr2/src/xdr/xdr_calib.o(.text._ZN3xdr12calibrate_rxEv)
    */lv0ldr2/src/xdr/xdr_calib.o(.text._ZN3xdr15store_zero_lineEj)
    */lv0ldr2/src/xdr/xdr_calib.o(.text._ZN3xdr14run_mic_cmd_c0Ev)
    */lv0ldr2/src/xdr/xdr_ptcal.o(.text._ZN3xdr12calibrate_txEv)
    */lv0ldr2/src/xdr/xdr_ptcal.o(.text._ZN3xdr16read_ptcal_startEv)
    */lv0ldr2/src/xdr/xdr_ptcal.o(.text._ZN3xdr20write_ptcal_settingsEv)
    */lv0ldr2/src/xdr/xdr_ptcal.o(.text._ZN7be_mmio8delay_msEj)
    */lv0ldr2/src/xdr/xdr_ptcal.o(.text._ZN3xdr12enable_ptcalEv)
    */lv0ldr2/src/xdr/xdr_dump.o(.text._ZN3xdr8dump_micEv)
    */lv0ldr2/src/xdr/xdr_dump.o(.text._ZN3xdr8dump_xioEv)
    */lv0ldr2/src/xdr/xdr_dump.o(.text._ZN3xdr8dump_xdrEv)
    */lv0ldr2/src/xdr/xdr_dump.o(.text._ZN3xdr9dump_regsEv)
    */lv0ldr2/src/xdr/xdr_dump.o(.text._ZN3xdr16prepare_iow_dumpEv)
    */lv0ldr2/src/xdr/xdr_serial.o(.text._Z10serial_bitPhh)
    */lv0ldr2/src/xdr/xdr_serial.o(.text._Z11serial_bytePhh)
    */lv0ldr2/src/xdr/xdr_serial.o(.text._ZN3xdr11serial_readEjthPt)
    */lv0ldr2/src/io/iommu.o(.text._ZN13iommu_contextC1Ev)
    */lv0ldr2/src/io/iommu.o(.text._Z17get_iommu_contextv)
    */lv0ldr2/src/io/iommu.o(.text._ZN13iommu_context19allocate_iopt_entryEPyj)
    */lv0ldr2/src/io/iommu.o(.text._ZN13iommu_context19allocate_iost_entryEPy)
    */lv0ldr2/src/io/iommu.o(.text._ZN13iommu_context22invalidate4_iopt_cacheEyj)
    */lv0ldr2/src/io/iommu.o(.text._ZN13iommu_context21invalidate_iost_cacheEy)
    */lv0ldr2/src/io/iommu.o(.text._ZN13iommu_context18clear_iopt_entriesEyj)
    */lv0ldr2/src/io/iommu.o(.text._ZN13iommu_context16clear_iost_entryEy)
    */lv0ldr2/src/io/iommu.o(.text._ZN13iommu_context7disableEv)
    */lv0ldr2/src/io/iommu.o(.text._ZN13iommu_context15free_io_addressEy)
    */lv0ldr2/src/io/iommu.o(.text._ZN13iommu_context10initializeEyyjyj)
    */lv0ldr2/src/io/iommu.o(.text._ZN13iommu_context19allocate_io_addressEjyjjjjjj)
    */lv0ldr2/src/flash/nand_flash_ctrl.o(.text._ZN15nand_flash_ctrl8set_baseEy)
    */lv0ldr2/src/util/mmio_access.o(.text._Z6read16y)
    */lv0ldr2/src/flash/nand_flash_ctrl.o(.text._ZN15nand_flash_ctrl8get_intrEv)
    */lv0ldr2/src/flash/nand_flash_ctrl.o(.text._ZN15nand_flash_ctrl10get_statusEv)
    */lv0ldr2/src/util/mmio_access.o(.text._Z7write16yt)
    */lv0ldr2/src/flash/nand_flash_ctrl.o(.text._ZN15nand_flash_ctrl4idleEv)
    */lv0ldr2/src/flash/nand_flash_ctrl.o(.text._ZN15nand_flash_ctrl17start_read_sectorEjtt)
    */lv0ldr2/src/flash/nand_flash_ctrl.o(.text._ZN15nand_flash_ctrl10start_idleEv)
    */lv0ldr2/src/flash/nand_flash_ctrl.o(.text._Z19get_nand_flash_ctrlv)
    */lv0ldr2/src/flash/nand_flash_transfer.o(.text._Z29set_nand_flash_ready_callbackPFbvE)
    */lv0ldr2/src/flash/nand_flash_transfer.o(.text._Z8kick_dmayj)
    */lv0ldr2/src/flash/nand_flash_transfer.o(.text._Z14get_dma_statusv)
    */lv0ldr2/src/flash/nand_flash_transfer.o(.text._ZN15nand_flash_ctrl16read_sectors_dmaEmjjPFbvE)
    */lv0ldr2/src/flash/nand_flash_transfer.o(.text._ZN15nand_flash_ctrl15read_sector_dmaEmjj)
    */lv0ldr2/src/util/delay.o(.text._Z15delay_dec_ticksi)
    */lv0ldr2/src/util/delay.o(.text._Z8delay_msj)
    */lv0ldr2/src/util/delay.o(.text._Z8delay_usj)
    */lv0ldr2/src/util/delay.o(.text._Z8delay_nsj)
    */lv0ldr2/src/util/delay.o(.text._Z17write_decrementerj)
    */lv0ldr2/src/util/delay.o(.text._Z17start_decrementerj)
    */lv1ldr/src/uart.o(.text._Z8get_uartv)
    */lv1ldr/src/uart.o(.text._ZN4uart4putcEl)
    */lv1ldr/src/uart.o(.text._ZN4uart4putsEPKc)
    */lv1ldr/src/uart.o(.text._ZN4uart4initEyiilbl)
    */lv1ldr/src/uart.o(.text._Z17uart_console_putsPKc)
    */lv0ldr2/src/flash/flash_probe.o(.text._Z10bswap16_lot)
    */lv0ldr2/src/flash/flash_probe.o(.text._Z13syscon_printfPKcz)
    */lv0ldr2/src/flash/flash_probe.o(.text._Z11uart_printfPKcz)
    */lv0ldr2/src/flash/flash_probe.o(.text._Z16probe_nand_flashy)
    */lv0ldr2/src/flash/flash_probe.o(.text._Z18identify_nor_flashy)
    */lv0ldr2/src/flash/flash_probe.o(.text._Z17detect_flash_typey)
    */lv0ldr2/src/platform/pio.o(.text._Z7get_piov)
    */lv0ldr2/src/platform/pio.o(.text._ZN3pio13reverse_bits8Eh)
    */lv0ldr2/src/platform/pio.o(.text._ZN3pio11read_fff504EPt)
    */lv0ldr2/src/platform/pio.o(.text._ZN3pio25is_ss2_interrupt_assertedEv)
    */lv0ldr2/src/platform/pio.o(.text._ZN3pio12write_fff500Et)
    */lv0ldr2/src/platform/pio.o(.text._ZN3pio17write_output_byteEh)
    */lv0ldr2/src/platform/pio.o(.text._ZN3pio9configureEytt)
    */lv0ldr2/src/platform/pio.o(.text._Z18poll_ss2_interruptv)
    */lv0ldr2/src/io/sb_registers.o(.text._Z6write8yh)
    */lv0ldr2/src/io/sb_registers.o(.text._ZN9sb_device14write8_100000aEih)
    */lv0ldr2/src/io/sb_registers.o(.text._ZN9sb_device14write8_100003aEh)
    */lv0ldr2/src/io/sb_registers.o(.text._Z18sb_dx_write32_1f60yj)
    */lv0ldr2/src/io/sb_registers.o(.text._Z18sb_dx_write32_1c74yj)
    */lv0ldr2/src/io/sb_registers.o(.text._Z18sb_dx_write32_1c70yj)
    */lv0ldr2/src/io/init_sb_device.o(.text._ZN9sb_device10initializeEyb)
    */lv0ldr2/src/io/get_sb_device.o(.text._Z13get_sb_devicev)
    */lv0ldr2/src/io/systemio_dmac_dx.o(.text._ZN16systemio_dmac_dxC1Ev)
    */lv0ldr2/src/io/systemio_dmac_dx.o(.text._Z20get_systemio_dmac_dxv)
    */lv0ldr2/src/io/systemio_dmac_dx.o(.text._ZN16systemio_dmac_dx9configureEyyyyy)
    */lv0ldr2/src/io/systemio_dmac_dx.o(.text._ZN16systemio_dmac_dx14get_dma_statusEv)
    */lv0ldr2/src/io/systemio_dmac_dx.o(.text._ZN16systemio_dmac_dx14start_transferEyyj)
    */lv0ldr2/src/io/systemio_dmac_dx.o(.text._ZN16systemio_dmac_dx8kick_dmaEyj)
    */lv0ldr2/src/io/systemio_dmac_px.o(.text._Z20get_systemio_dmac_pxv)
    */lv0ldr2/src/io/systemio_dmac_px.o(.text._ZN16systemio_dmac_px9configureEyyyj)
    */lv0ldr2/src/io/systemio_dmac_px.o(.text._ZN16systemio_dmac_px26is_ebus_interrupt_assertedEv)
    */lv0ldr2/src/io/systemio_dmac_px.o(.text._Z19poll_ebus_interruptv)
    */lv0ldr2/src/io/systemio_dmac_px.o(.text._ZN16systemio_dmac_px14get_dma_statusEv)
    */lv0ldr2/src/io/systemio_dmac_px.o(.text._ZN16systemio_dmac_px8kick_dmaEyj)
    */lv0ldr2/src/io/iopt.o(.text._Z20iopt_unpack_entry_v1yjP9iopt_desc)
    */lv0ldr2/src/io/iopt.o(.text._Z18iopt_pack_entry_v1yjP9iopt_desc)
    */lv0ldr2/src/io/iopt.o(.text._Z20iopt_unpack_entry_v2yjP9iopt_desc)
    */lv0ldr2/src/io/iopt.o(.text._ZN10iopt_codec12unpack_entryEyjPv)
    */lv0ldr2/src/io/iopt.o(.text._Z18iopt_pack_entry_v2yjP9iopt_desc)
    */lv0ldr2/src/io/iopt.o(.text._ZN10iopt_codec10pack_entryEyjPv)
    */lv0ldr2/src/syscon/syscon_config.o(.text._Z22syscon_get_clock_valuePjhhb)
    */lv0ldr2/src/syscon/syscon_config.o(.text._Z20syscon_get_ref_clockPjb)
    */lv0ldr2/src/syscon/syscon_xdr.o(.text._Z22syscon_read_xdr_configPv)
    */lv0ldr2/src/syscon/syscon_xdr.o(.text._Z20syscon_read_config_2Pj)
    */lv0ldr2/src/syscon/syscon_xdr.o(.text._Z23syscon_write_xdr_configjj)
    */lv0ldr2/src/syscon/syscon_xdr.o(.text._Z19syscon_set_xdr_railhh)
    */lv0ldr2/src/syscon/sc_console.o(.text._Z19syscon_write_stringPKc)
    */lv0ldr2/src/syscon/syscon.o(.text._ZN6syscon20get_protocol_versionEv)
    */lv0ldr2/src/syscon/syscon.o(.text._ZN6syscon6set_f8Eh)
    */lv0ldr2/src/syscon/syscon.o(.text._ZN6syscon16sc_calc_checksumEPhjPt)
    */lv0ldr2/src/syscon/syscon.o(.text._ZN6syscon20sc_calc_checksum_negEPhjPt)
    */lv0ldr2/src/syscon/syscon.o(.text._ZN6syscon11read_swbintEv)
    */lv0ldr2/src/syscon/syscon.o(.text._ZN6syscon22get_swbint_status_ver1Ev)
    */lv0ldr2/src/syscon/syscon.o(.text._ZN6syscon17get_swbint_statusEv)
    */lv0ldr2/src/syscon/syscon.o(.text._ZN6syscon11wait_swbintEl)
    */lv0ldr2/src/syscon/syscon.o(.text._ZN6syscon18raise_sc_interruptEm)
    */lv0ldr2/src/syscon/syscon.o(.text._ZN6syscon18read_cmpl_msg_ver1EPiPvjS0_P10sc_msg_ids)
    */lv0ldr2/src/syscon/syscon.o(.text._ZN6syscon13read_cmpl_msgEPiPvjS0_P10sc_msg_ids)
    */lv0ldr2/src/syscon/syscon.o(.text._ZN6syscon19write_init_msg_ver1ElPKvmP10sc_msg_idsb)
    */lv0ldr2/src/syscon/syscon.o(.text._ZN6syscon14write_init_msgElPKvjP10sc_msg_ids)
    */lv0ldr2/src/syscon/syscon.o(.text._ZN6syscon10initializeEyib)
    */lv0ldr2/src/syscon/syscon.o(.text._ZN6syscon16send_and_receiveEjPKvjPvjPii)
    */lv0ldr2/src/syscon/syscon.o(.text._Z17get_syscon_devicev)
    */lv0ldr2/src/syscon/syscon_power.o(.text._Z21syscon_power_query_33Pj)
    */lv0ldr2/src/syscon/syscon_power.o(.text._Z22syscon_set_wake_sourcej)
    */lv0ldr2/src/syscon/syscon_power.o(.text._Z20syscon_get_wake_infoPhS_S_S_S_Pj)
    */lv0ldr2/src/syscon/syscon_power.o(.text._Z26syscon_power_off_with_codeiii)
    */lv0ldr2/src/storage/nv_storage.o(.text._Z26is_sc_nv_storage_supportedv)
    */lv0ldr2/src/storage/nv_storage.o(.text._ZN10nv_storage5writeEjjjPvj)
    */lv0ldr2/src/storage/nv_storage.o(.text._ZN10nv_storage4readEjjjPvj)
    */lv0ldr2/src/storage/nv_storage.o(.text._Z13load_nv_entryj)
    */lv0ldr2/src/syscon/sc_nv_storage.o(.text._ZN13sc_nv_storage12check_statusEh)
    */lv0ldr2/src/syscon/sc_nv_storage.o(.text._ZN13sc_nv_storage5writeEjjjPKv)
    */lv0ldr2/src/syscon/sc_nv_storage.o(.text._ZN13sc_nv_storage4readEjjjPvPj)
    */lv0ldr2/src/log/log.o(.text._Z15log_set_handleriPFlPKcE)
    */lv0ldr2/src/log/log.o(.text._Z17log_set_thresholdi)
    */lv0ldr2/src/log/log.o(.text._Z21log_set_final_handlerPFlvE)
    */lv0ldr2/src/log/log.o(.text._Z12log_dispatchiiPKcP13__va_list_tag)
    */lv0ldr2/src/log/log.o(.text._Z9log_errorjPKcz)
    */lv0ldr2/src/log/log.o(.text._Z9log_debugPKcz)
    */lv0ldr2/src/log/log.o(.text._Z8log_infoPKcz)
    */lv0ldr2/src/log/log.o(.text._Z11log_messagePKcz)
    */lv0ldr2/src/boot/exit.o(.text.exit)
    */lv1ldr/src/printf.o(.text._Z19lv0_vfprintf_enginePFilPlllEljPKhP13__va_list_tag)
    */lv1ldr/src/printf.o(.text._Z17snprintf_put_charPPcPjli)
    */lv1ldr/src/printf.o(.text._Z13lv0_vsnprintfPcmPKcP13__va_list_tag)
    */lv0ldr/src/util/memcmp.o(.text.memcmp)
    */isoldr/src/memset.o(.text.memset)
    */lv0ldr2/src/util/strncmp.o(.text.strncmp)
    */isoldr/src/memcpy.o(.text.memcpy)
    */lv1ldr/src/uart.o(.text.strlen)
    */lv0ldr/libgcc/divdi3.o(.text)
    */lv0ldr/libgcc/moddi3.o(.text)
    */lv0ldr/libgcc/udivdi3.o(.text)
    */lv0ldr/libgcc/umoddi3.o(.text)
    *(.text .text.* .gnu.linkonce.t.*)
  }

  .rodata ALIGN(0x10) :
  {
    */lv0ldr2/src/boot/loader.o(.rodata.str1.16)
    */lv0ldr2/src/boot/loader.o(.rodata.cst16)
    *(.rodata._ZTV6loader)
    */lv0ldr2/src/util/mmio_access.o(.rodata.cst16)
    */lv0ldr2/src/auth/loader_auth.o(.rodata.cst16)
    */lv0ldr2/src/auth/loader_auth.o(.rodata.lv0_curve)
    */lv0ldr2/src/auth/loader_auth.o(.rodata.lv0_header_key)
    */lv0ldr2/src/auth/loader_auth.o(.rodata.lv0_header_iv)
    */lv0ldr2/src/platform/config_ring.o(.rodata.str1.16)
    */lv0ldr2/src/platform/config_ring.o(.rodata.cst16)
    */lv0ldr2/src/platform/config_ring.o(.rodata.config_ring_vary)
    */lv0ldr2/src/platform/config_ring.o(.rodata.config_ring_vary_2)
    */lv0ldr2/src/auth/authenticator.o(.rodata.cst16)
    *(.rodata._ZTV17aes128_ctr_cipher)
    *(.rodata._ZTV17aes256_cbc_cipher)
    *(.rodata._ZTV6cipher)
    *(.rodata._ZTV14ecdsa_verifier)
    *(.rodata._ZTV8verifier)
    */lv1ldr/src/auth_buffers.o(.rodata.cst16)
    *(.rodata._ZTV10dma_buffer)
    *(.rodata._ZTV17tagged_dma_buffer)
    */lv0ldr/crypto/aes_modes.o(.rodata.cst16)
    */lv0ldr/crypto/aes_set_encrypt_key.o(.rodata)
    */lv0ldr/crypto/aes_set_encrypt_key.o(.rodata.cst16)
    */lv0ldr/crypto/aes_set_decrypt_key.o(.rodata.cst16)
    */lv0ldr/crypto/aes_encrypt_block.o(.rodata.cst16)
    */lv0ldr/crypto/aes_encrypt8.o(.rodata.cst16)
    */lv0ldr/crypto/aes_decrypt_block.o(.rodata.cst16)
    */lv0ldr/crypto/aes_decrypt8.o(.rodata.cst16)
    */lv0ldr/crypto/sha1_transform.o(.rodata.cst16)
    */lv0ldr/crypto/ec_curve_table.o(.rodata)
    */lv0ldr2/src/auth/auth_data.o(.rodata.key_slots)
    */lv0ldr2/src/auth/auth_data.o(.rodata.digest_slots)
    */lv0ldr2/src/auth/auth_data.o(.rodata.sig_sizes)
    */lv0ldr2/src/auth/auth_check.o(.rodata.cst16)
    */lv0ldr2/src/auth/auth_data.o(.rodata.control_digest)
    */lv0ldr2/src/boot/loader_unit.o(.rodata.str1.16)
    */lv0ldr2/src/boot/loader_unit.o(.rodata.cst16)
    */lv0ldr2/src/boot/loader_unit.o(.rodata._ZZ20get_boot_memory_typevE13function_name)
    */lv0ldr2/src/boot/loader_unit.o(.rodata._ZZN11loader_base19copy_to_main_memoryEyjE13function_name)
    */lv0ldr2/src/boot/loader_unit.o(.rodata.xio_regs_7)
    */lv0ldr2/src/boot/loader_unit.o(.rodata.xio_regs_11)
    */lv0ldr2/src/boot/loader_unit.o(.rodata.xio_regs_12)
    */lv0ldr2/src/boot/loader_unit.o(.rodata.tbr_divider_lfsr_table)
    */lv0ldr2/src/boot/sc_config_info.o(.rodata.str1.16)
    */lv0ldr2/src/boot/memory_diag.o(.rodata.cst16)
    */lv0ldr2/src/boot/memory_diag.o(.rodata.str1.16)
    */lv0ldr2/src/platform/be_mmio.o(.rodata.be_mmio_base)
    */lv0ldr2/src/xdr/xdr.o(.rodata.str1.16)
    */lv0ldr2/src/platform/be_mmio.o(.rodata.mic_timing_reg)
    */lv0ldr2/src/xdr/xdr.o(.rodata._ZZN3xdr8bank_mapEijE3C.8)
    */lv0ldr2/src/platform/be_mmio.o(.rodata.mic_timing_b_reg)
    */lv0ldr2/src/xdr/xdr_calib.o(.rodata.str1.16)
    */lv0ldr2/src/xdr/xdr_calib.o(.rodata.mic_read_reg)
    */lv0ldr2/src/xdr/xdr_ptcal.o(.rodata.str1.16)
    */lv0ldr2/src/xdr/xdr_dump.o(.rodata.str1.16)
    */lv0ldr2/src/xdr/xdr_dump.o(.rodata._ZZN3xdr8dump_xdrEvE3C.2)
    */lv0ldr2/src/xdr/xdr_dump.o(.rodata._ZZN3xdr8dump_xioEvE3C.6)
    */lv0ldr2/src/xdr/xdr_dump.o(.rodata._ZZN3xdr8dump_micEvE3C.9)
    */lv0ldr2/src/io/iommu.o(.rodata.cst16)
    */lv0ldr2/src/io/iommu.o(.rodata.str1.16)
    */lv0ldr2/src/io/iommu.o(.rodata._ZZN13iommu_context19allocate_io_addressEjyjjjjjjE13function_name)
    */lv0ldr2/src/flash/nand_flash_ctrl.o(.rodata.cst16)
    */lv0ldr2/src/flash/nand_flash_ctrl.o(.rodata.str1.16)
    */lv0ldr2/src/flash/nand_flash_ctrl.o(.rodata._ZZN15nand_flash_ctrl4idleEvE12__FUNCTION__)
    */lv0ldr2/src/flash/nand_flash_transfer.o(.rodata.str1.16)
    */lv0ldr2/src/flash/nand_flash_transfer.o(.rodata._ZZN15nand_flash_ctrl16read_sectors_dmaEmjjPFbvEE12__FUNCTION__)
    */lv1ldr/src/uart.o(.rodata.cst16)
    */lv0ldr2/src/flash/flash_probe.o(.rodata.cst16)
    */lv0ldr2/src/platform/pio.o(.rodata.cst16)
    */lv0ldr2/src/platform/pio.o(.rodata.str1.16)
    */lv0ldr2/src/platform/pio.o(.rodata._ZZN3pio25is_ss2_interrupt_assertedEvE12__FUNCTION__)
    */lv0ldr2/src/io/sb_registers.o(.rodata.cst16)
    */lv0ldr2/src/io/init_sb_device.o(.rodata.cst16)
    */lv0ldr2/src/io/systemio_dmac_dx.o(.rodata.cst16)
    */lv0ldr2/src/io/systemio_dmac_dx.o(.rodata.str1.16)
    */lv0ldr2/src/io/systemio_dmac_dx.o(.rodata._ZZN16systemio_dmac_dx14get_dma_statusEvE12__FUNCTION__)
    */lv0ldr2/src/io/systemio_dmac_px.o(.rodata.cst16)
    */lv0ldr2/src/io/systemio_dmac_px.o(.rodata.str1.16)
    */lv0ldr2/src/io/systemio_dmac_px.o(.rodata._ZZN16systemio_dmac_px26is_ebus_interrupt_assertedEvE12__FUNCTION__)
    */lv0ldr2/src/io/systemio_dmac_px.o(.rodata._ZZN16systemio_dmac_px14get_dma_statusEvE12__FUNCTION__)
    */lv0ldr2/src/io/iopt.o(.rodata.cst16)
    */lv0ldr2/src/io/iopt.o(.rodata.str1.16)
    */lv0ldr2/src/syscon/syscon.o(.rodata.cst16)
    */lv0ldr2/src/syscon/syscon.o(.rodata.str1.16)
    */lv0ldr2/src/syscon/syscon.o(.rodata._ZZN6syscon18read_cmpl_msg_ver1EPiPvjS0_P10sc_msg_idsE13function_name)
    */lv0ldr2/src/syscon/syscon.o(.rodata._ZZN6syscon19write_init_msg_ver1ElPKvmP10sc_msg_idsbE13function_name)
    */lv0ldr2/src/syscon/syscon.o(.rodata._ZZN6syscon16send_and_receiveEjPKvjPvjPiiE13function_name)
    */lv0ldr2/src/storage/nv_storage.o(.rodata.str1.16)
    */lv0ldr2/src/syscon/sc_nv_storage.o(.rodata.str1.16)
    */lv1ldr/src/printf.o(.rodata.str1.16)
    */lv1ldr/src/printf.o(.rodata.cst16)
    */lv0ldr2/src/util/shuffle_table.o(.rodata.shuffle_table)
    *(.rodata .rodata.* .gnu.linkonce.r.*)
  }

  .data ALIGN(0x10) :
  {
    */lv0ldr2/src/dma/dma.o(.data._ZZ8dma_waitvE5first)
    */lv0ldr2/src/auth/loader_auth.o(.data.lv0_public_key)
    */lv0ldr2/src/platform/config_ring.o(.data.config_ring_expected)
    */lv0ldr2/src/platform/config_ring.o(.data.config_ring_expected_2)
    */lv0ldr2/src/boot/loader_unit.o(.data.g_dma_io_addr)
    */lv0ldr2/src/boot/loader_unit.o(.data.g_ss2_work_offset)
    */lv0ldr2/src/boot/loader_unit.o(.data.g_first_spu_priv1_20)
    */lv0ldr2/src/xdr/xdr_calib.o(.data.xdr_rows_28870)
    */lv0ldr2/src/xdr/xdr_calib.o(.data.xdr_t45_x)
    */lv0ldr2/src/xdr/xdr_calib.o(.data.xdr_t45_y)
    */lv0ldr2/src/xdr/xdr_calib.o(.data.xdr_t4_x)
    */lv0ldr2/src/xdr/xdr_calib.o(.data.xdr_t4_y)
    */lv0ldr2/src/xdr/xdr_calib.o(.data.xdr_t7_x)
    */lv0ldr2/src/xdr/xdr_calib.o(.data.xdr_t7_y)
    */lv0ldr2/src/xdr/xdr_calib.o(.data.xdr_t32_x)
    */lv0ldr2/src/xdr/xdr_calib.o(.data.xdr_t32_y)
    */lv0ldr2/src/xdr/xdr_calib.o(.data.xdr_t33_x)
    */lv0ldr2/src/xdr/xdr_calib.o(.data.xdr_t33_y)
    */lv0ldr2/src/xdr/xdr_calib.o(.data.xdr_t41_x)
    */lv0ldr2/src/xdr/xdr_calib.o(.data.xdr_t41_y)
    */lv0ldr2/src/xdr/xdr_calib.o(.data.xdr_t0_x)
    */lv0ldr2/src/xdr/xdr_calib.o(.data.xdr_t0_y)
    */lv0ldr2/src/xdr/xdr_calib.o(.data.xdr_r4_k11_x)
    */lv0ldr2/src/xdr/xdr_calib.o(.data.xdr_r4_k11_y)
    */lv0ldr2/src/xdr/xdr_calib.o(.data.xdr_r8x5_k11_x)
    */lv0ldr2/src/xdr/xdr_calib.o(.data.xdr_r8x5_k11_y)
    */lv0ldr2/src/xdr/xdr_calib.o(.data.xdr_r8x4_k11_x)
    */lv0ldr2/src/xdr/xdr_calib.o(.data.xdr_r8x4_k11_y)
    */lv0ldr2/src/xdr/xdr_calib.o(.data.xdr_r16_k11_x)
    */lv0ldr2/src/xdr/xdr_calib.o(.data.xdr_r16_k11_y)
    */lv0ldr2/src/xdr/xdr_calib.o(.data.xdr_r4_x)
    */lv0ldr2/src/xdr/xdr_calib.o(.data.xdr_r4_y)
    */lv0ldr2/src/xdr/xdr_calib.o(.data.xdr_r8x5_x)
    */lv0ldr2/src/xdr/xdr_calib.o(.data.xdr_r8x5_y)
    */lv0ldr2/src/xdr/xdr_calib.o(.data.xdr_r8x4_x)
    */lv0ldr2/src/xdr/xdr_calib.o(.data.xdr_r8x4_y)
    */lv0ldr2/src/xdr/xdr_calib.o(.data.xdr_r16_x)
    */lv0ldr2/src/xdr/xdr_calib.o(.data.xdr_r16_y)
    */lv0ldr2/src/util/delay.o(.data.timebase_frequency)
    */lv0ldr2/src/syscon/syscon_power.o(.data.g_sc_wake_info_format)
    */lv0ldr2/src/storage/nv_storage.o(.data.g_nv_entry_table)
    */lv0ldr2/src/log/log.o(.data.g_log_threshold)
    */lv0ldr2/src/boot/spu_memtest.o(.data.spu_memtest)
    *(.data .data.* .gnu.linkonce.d.*)
  }

  .ctors ALIGN(0x80) : { KEEP(*(.ctors)) __CTOR_END__ = .; }
  .dtors : { KEEP(*(.dtors)) }

  .bss ALIGN(0x10) :
  {
    */lv0ldr2/src/auth/loader_auth.o(.bss.g_auth)
    */lv1ldr/src/auth_buffers.o(.bss.g_part_area)
    */lv1ldr/src/auth_buffers.o(.bss.g_part_digest)
    */lv1ldr/src/auth_buffers.o(.bss.g_header)
    */isoldr/src/cipher_aes256_cbc.o(.bss.g_aes256_cbc)
    */isoldr/src/cipher_aes128_ctr.o(.bss.g_aes128_ctr)
    */isoldr/src/verifier_ecdsa.o(.bss.verify_hash)
    */isoldr/src/hmac_digest.o(.bss.g_hmac)
    */isoldr/src/dma_buffer.o(.bss.g_dma_mfc)
    */lv0ldr2/src/boot/loader_unit.o(.bss.g_flash_format)
    */lv0ldr2/src/boot/loader_unit.o(.bss.g_post_flag_80)
    */lv0ldr2/src/boot/loader_unit.o(.bss.g_post_flag_40)
    */lv0ldr2/src/boot/loader_unit.o(.bss.g_flash_format_window_mapped)
    */lv0ldr2/src/boot/loader_unit.o(.bss.g_boot_memory_type)
    */lv0ldr2/src/boot/loader_unit.o(.bss.g_boot_memory_type_checked)
    */lv0ldr2/src/xdr/xdr_calib.o(.bss.xdr_rows)
    */lv0ldr2/src/io/iommu.o(.bss._ZGVZ17get_iommu_contextvE3ctx)
    */lv0ldr2/src/io/iommu.o(.bss._ZZ17get_iommu_contextvE3ctx)
    */lv0ldr2/src/flash/nand_flash_ctrl.o(.bss._ZGVZ19get_nand_flash_ctrlvE4ctrl)
    */lv0ldr2/src/flash/nand_flash_ctrl.o(.bss._ZZ19get_nand_flash_ctrlvE4ctrl)
    */lv0ldr2/src/flash/nand_flash_transfer.o(.bss.g_nand_flash_ready_callback)
    */lv1ldr/src/uart.o(.bss._ZGVZ8get_uartvE7console)
    */lv1ldr/src/uart.o(.bss._ZZ8get_uartvE7console)
    */lv0ldr2/src/platform/pio.o(.bss._ZGVZ7get_piovE5block)
    */lv0ldr2/src/platform/pio.o(.bss._ZZ7get_piovE5block)
    */lv0ldr2/src/io/get_sb_device.o(.bss._ZGVZ13get_sb_devicevE6device)
    */lv0ldr2/src/io/get_sb_device.o(.bss._ZZ13get_sb_devicevE6device)
    */lv0ldr2/src/io/systemio_dmac_dx.o(.bss._ZGVZ20get_systemio_dmac_dxvE4dmac)
    */lv0ldr2/src/io/systemio_dmac_dx.o(.bss._ZZ20get_systemio_dmac_dxvE4dmac)
    */lv0ldr2/src/io/systemio_dmac_px.o(.bss._ZGVZ20get_systemio_dmac_pxvE4dmac)
    */lv0ldr2/src/io/systemio_dmac_px.o(.bss._ZZ20get_systemio_dmac_pxvE4dmac)
    */lv0ldr2/src/syscon/sc_console.o(.bss.g_sc_console_buffer)
    */lv0ldr2/src/syscon/syscon.o(.bss.g_sc_msg_buffer)
    */lv0ldr2/src/syscon/syscon.o(.bss.g_sc_swbint_pending)
    */lv0ldr2/src/syscon/syscon.o(.bss.g_send_and_receive_transaction_id)
    */lv0ldr2/src/syscon/syscon.o(.bss._ZGVZ17get_syscon_devicevE6device)
    */lv0ldr2/src/syscon/syscon.o(.bss._ZZ17get_syscon_devicevE6device)
    */lv0ldr2/src/storage/nv_storage.o(.bss.nv_buf_48000)
    */lv0ldr2/src/storage/nv_storage.o(.bss.nv_buf_48800)
    */lv0ldr2/src/storage/nv_storage.o(.bss.nv_buf_48c00)
    */lv0ldr2/src/storage/nv_storage.o(.bss.nv_buf_48c22)
    */lv0ldr2/src/storage/nv_storage.o(.bss.nv_buf_48c30)
    */lv0ldr2/src/storage/nv_storage.o(.bss.nv_buf_48c40)
    */lv0ldr2/src/storage/nv_storage.o(.bss.nv_buf_48c80)
    */lv0ldr2/src/storage/nv_storage.o(.bss.nv_buf_48c90)
    */lv0ldr2/src/storage/nv_storage.o(.bss.g_sc_nv_storage_version)
    */lv0ldr2/src/storage/nv_storage.o(.bss.g_sc_nv_storage_version_initialized)
    */lv0ldr2/src/log/log.o(.bss.g_log_handlers)
    */lv0ldr2/src/log/log.o(.bss.g_log_final_handler)
    *(.bss .bss.* .gnu.linkonce.b.*)
    *(COMMON)
  }

  /DISCARD/ : { *(.dropped) *(.comment) *(.note*) *(.eh_frame) }
}

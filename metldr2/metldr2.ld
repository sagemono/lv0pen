/* metldr2.ld -- metldr.2's link: its decrypted body at 0x400-0xFCE0 as
 * the image has it, every function's section placed at its address in
 * the image's order (one line a section; the C1/C2 pairs are one body,
 * --gc-sections keeps the one the code calls), then the data. */

ENTRY(entry)

SECTIONS
{
  . = 0x400;

  .text :
  {
    */metldr2/src/entry.o(.text)
    */metldr2/src/exit_stop.o(.text.exit_stop)
    */metldr2/src/exit_stop.o(.data.exit_status)
    */metldr2/src/entry.o(.text.leave)
    */isoldr/src/crt0.o(.text)
    */metldr2/src/loader_global.o(.text._Z41__static_initialization_and_destruction_0ii)
    */metldr2/src/loader_global.o(.text._GLOBAL__I_g_loader)
    */metldr2/src/main.o(.text.main)
    *(.text._ZN6cipher6vslot6EPKv)
    *(.text._ZN6cipher6vslot7EPv)
    */metldr2/src/loader.o(.text._ZN6loaderC1Ev)
    */metldr2/src/loader.o(.text._ZN6loaderC2Ev)
    *(.text._ZN6cipherD0Ev)
    *(.text._ZN6cipherD1Ev)
    */metldr2/src/loader.o(.text._ZN6loader13check_versionEv)
    *(.text._ZN12local_bufferD1Ev)
    *(.text._ZN17tagged_dma_bufferD1Ev)
    */metldr2/src/loader.o(.text._ZN6loader11load_headerEv)
    */metldr2/src/loader.o(.text._ZN6loader13load_segmentsEPj)
    */metldr2/src/loader.o(.text._ZN6loader4loadEPj)
    */metldr2/src/loader.o(.text._ZN6loader12read_requestEv)
    */metldr2/src/loader.o(.text._ZN6loader3runEPj)
    */metldr2/src/authenticator.o(.text._ZN9elf_imageC1Ev)
    */metldr2/src/authenticator.o(.text._ZN9elf_image4loadEPKv)
    */metldr2/src/authenticator.o(.text._ZN13authenticator10set_offsetEy)
    */metldr2/src/authenticator.o(.text._ZN13authenticator14check_app_infoEPK13auth_app_infoj)
    *(.text._ZN8verifierD0Ev)
    *(.text._ZN8verifierD1Ev)
    *(.text._ZN8verifierD2Ev)
    */isoldr/src/verifier_ecdsa.o(.text._ZN14ecdsa_verifierD0Ev)
    *(.text._ZN14ecdsa_verifierD1Ev)
    *(.text._ZN6cipherD2Ev)
    */isoldr/src/cipher_aes256_cbc.o(.text._ZN17aes256_cbc_cipherD0Ev)
    *(.text._ZN17aes256_cbc_cipherD1Ev)
    */isoldr/src/cipher_aes128_ctr.o(.text._ZN17aes128_ctr_cipherD0Ev)
    */isoldr/src/cipher_aes128_ctr.o(.text._ZN17aes128_ctr_cipherD1Ev)
    */metldr2/src/authenticator.o(.text._ZN13authenticator9check_appEP9sce_imagej)
    */metldr2/src/authenticator.o(.text._ZN13authenticator11load_headerEjPKhS1_S1_PKjPP10dma_bufferj)
    */metldr2/src/authenticator.o(.text._ZN13authenticatorC1Ev)
    */metldr2/src/authenticator.o(.text._ZN13authenticatorC2Ev)
    */metldr2/src/authenticator.o(.text._ZN13authenticator19read_program_headerEjP10Elf32_Phdr)
    */metldr2/src/authenticator.o(.text._ZN13authenticator15read_elf_headerEP10Elf32_Ehdr)
    */isoldr/src/cipher_aes128_ctr.o(.text._ZN17aes128_ctr_cipherC1Ev)
    */isoldr/src/cipher_aes128_ctr.o(.text._Z41__static_initialization_and_destruction_0ii)
    */isoldr/src/cipher_aes128_ctr.o(.text._GLOBAL__D_g_aes128_ctr)
    */isoldr/src/cipher_aes128_ctr.o(.text._GLOBAL__I_g_aes128_ctr)
    */isoldr/src/cipher_aes128_ctr.o(.text._ZN17aes128_ctr_cipher7decryptEPKviPv)
    */isoldr/src/cipher_aes128_ctr.o(.text._ZN17aes128_ctr_cipher7set_keyEPKhS1_)
    *(.text._ZN17aes256_cbc_cipherC1Ev)
    */isoldr/src/cipher_aes256_cbc.o(.text._Z41__static_initialization_and_destruction_0ii)
    */isoldr/src/cipher_aes256_cbc.o(.text._GLOBAL__D_g_aes256_cbc)
    */isoldr/src/cipher_aes256_cbc.o(.text._GLOBAL__I_g_aes256_cbc)
    */isoldr/src/cipher_aes256_cbc.o(.text._ZN17aes256_cbc_cipher7decryptEPKviPv)
    */isoldr/src/cipher_aes256_cbc.o(.text._ZN17aes256_cbc_cipher7set_keyEPKhS1_)
    */isoldr/src/verifier_ecdsa.o(.text._ZN14ecdsa_verifier6verifyEPKhiS1_)
    */isoldr/src/verifier_ecdsa.o(.text._ZN14ecdsa_verifierC1EPKhj)
    */isoldr/src/verifier_ecdsa.o(.text._ZN14ecdsa_verifierC2EPKhj)
    */metldr2/src/auth_buffers.o(.text._ZN13authenticator12get_app_infoEP13auth_app_info)
    */metldr2/src/auth_buffers.o(.text._ZN9auth_sink6appendEPKU8__vectorhS2_)
    */metldr2/src/auth_buffers.o(.text._ZN13authenticator10read_partsEv)
    */metldr2/src/auth_segments.o(.text._ZN13authenticator12load_segmentEjjyyPP10dma_bufferiS2_i)
    */metldr2/src/auth_segments.o(.text._ZN13authenticator15transfer_storedEv)
    */metldr2/src/elf_reader.o(.text._ZN9elf_image10get_headerEP10Elf32_Ehdr)
    */metldr2/src/elf_reader.o(.text._ZN9elf_image18get_program_headerEjP10Elf32_Phdr)
    */isoldr/src/hmac_digest.o(.text._ZN11hmac_digestC1Ev)
    */isoldr/src/hmac_digest.o(.text._ZN11hmac_digestC2Ev)
    */isoldr/src/hmac_digest.o(.text._Z41__static_initialization_and_destruction_0ii)
    */isoldr/src/hmac_digest.o(.text._GLOBAL__I_g_hmac)
    */isoldr/src/hmac_digest.o(.text._GLOBAL__D_g_hmac)
    */isoldr/src/hmac_digest.o(.text._ZN11hmac_digest6updateEPKhi)
    */isoldr/src/hmac_digest.o(.text._ZN11hmac_digest5finalEPh)
    */isoldr/src/hmac_digest.o(.text._ZN11hmac_digest4initEPKhj)
    */metldr2/src/auth_buffers.o(.text._ZN13authenticator12find_sectionEjjP12auth_section)
    */lv2ldr/src/hash_reader.o(.text._Z12bytes_differPKhS0_i)
    */metldr2/src/auth_buffers.o(.text._ZN13authenticator17check_part_digestEPK12auth_section)
    */metldr2/src/auth_buffers.o(.text._ZN13authenticator9save_tailEPK10dma_buffer)
    */metldr2/src/auth_buffers.o(.text._ZN13authenticator12restore_tailEPK10dma_buffer)
    */metldr2/src/auth_buffers.o(.text._ZN13authenticator7prependEPK10dma_bufferj)
    */isoldr/src/dma_queue.o(.text._ZN9dma_queue12enqueue_readEP10dma_buffer)
    */isoldr/src/dma_queue.o(.text._ZN9dma_queue7dequeueEPP10dma_bufferP9list_nodeMS0_FbvE)
    */isoldr/src/dma_queue.o(.text._ZN9dma_queue12dequeue_readEPP10dma_buffer)
    */isoldr/src/dma_queue.o(.text._ZN9dma_queue5drainEP9list_nodeM10dma_bufferFbvE)
    */isoldr/src/dma_queue.o(.text._ZN9dma_queue5closeEv)
    */isoldr/src/dma_queue.o(.text._ZN9dma_queueC1Ev)
    */isoldr/src/dma_queue.o(.text._ZN9dma_queueC2Ev)
    */isoldr/src/dma_queue.o(.text._ZN9dma_queue11add_writtenEP10dma_buffer)
    */isoldr/src/dma_queue.o(.text._ZN9dma_queue13enqueue_writeEP10dma_buffer)
    */isoldr/src/dma_queue.o(.text._ZN9dma_queue13dequeue_writeEPP10dma_buffer)
    */isoldr/src/dma_queue.o(.text._ZN9dma_queue4openEyjyj)
    */isoldr/src/dma_buffer.o(.text._ZN10dma_buffer10set_bufferEjj)
    *(.text._ZN10dma_bufferD0Ev)
    *(.text._ZN10dma_bufferD1Ev)
    *(.text._ZN10dma_bufferD2Ev)
    */isoldr/src/dma_buffer.o(.text._ZN10dma_bufferC1Ev)
    */isoldr/src/dma_buffer.o(.text._ZN10dma_bufferC2Ev)
    */isoldr/src/dma_buffer.o(.text._ZN17tagged_dma_buffer9max_chunkEj)
    */isoldr/src/dma_buffer_io.o(.text._ZN17tagged_dma_bufferD0Ev)
    *(.text._ZN7dma_mfcC1Ev)
    */isoldr/src/dma_buffer.o(.text._Z41__static_initialization_and_destruction_0ii)
    */isoldr/src/dma_buffer.o(.text._GLOBAL__I__ZN10dma_bufferC2Ev)
    */isoldr/src/dma_buffer.o(.text._ZN17tagged_dma_buffer8transferEyyjj)
    */isoldr/src/dma_buffer.o(.text._ZN17tagged_dma_buffer8put_doneEv)
    */isoldr/src/dma_buffer.o(.text._ZN17tagged_dma_buffer8get_doneEv)
    */isoldr/src/dma_buffer.o(.text._ZN17tagged_dma_bufferC1Ej)
    */isoldr/src/dma_buffer.o(.text._ZN17tagged_dma_bufferC2Ej)
    */isoldr/src/dma_buffer_io.o(.text._ZN17tagged_dma_buffer3putEyjPj)
    */isoldr/src/dma_buffer_io.o(.text._ZN17tagged_dma_buffer3getEyjPj)
    */isoldr/src/local_buffer.o(.text._ZN12local_buffer3getEyjPj)
    */isoldr/src/local_buffer.o(.text._ZN12local_buffer8get_doneEv)
    */isoldr/src/local_buffer.o(.text._ZN12local_buffer8put_doneEv)
    */isoldr/src/local_buffer.o(.text._ZN12local_bufferD0Ev)
    */isoldr/src/local_buffer.o(.text._ZN12local_bufferC1Ev)
    */isoldr/src/local_buffer.o(.text._ZN12local_bufferC2Ev)
    */isoldr/src/local_buffer.o(.text._ZN12local_buffer3putEyjPj)
    */lv0ldr/crypto/aes_modes.o(.text)
    */lv0ldr/crypto/sha1_digest.o(.text)
    */lv0ldr/crypto/hmac_sha1.o(.text)
    */lv0ldr/crypto/aes_set_encrypt_key.o(.text)
    */lv0ldr/crypto/aes_set_decrypt_key.o(.text)
    */lv0ldr/crypto/aes_encrypt_block.o(.text)
    */lv0ldr/crypto/aes_encrypt8.o(.text)
    */lv0ldr/crypto/aes_decrypt_block.o(.text)
    */lv0ldr/crypto/aes_decrypt8.o(.text)
    */lv0ldr/crypto/sha1.o(.text)
    */lv0ldr/crypto/sha1_transform.o(.text)
    */lv0ldr/crypto/ecdsa_id.o(.text)
    */lv0ldr/crypto/ec_curves.o(.text)
    */isoldr/crypto/ecdsa.o(.text)
    */lv0ldr/crypto/ec.o(.text)
    */lv0ldr/crypto/ec_mul2.o(.text)
    */lv0ldr/crypto/bn_core.o(.text)
    */lv0ldr/crypto/bn_in_range.o(.text)
    */lv0ldr/crypto/ec_curve_valid.o(.text)
    */lv0ldr/crypto/bn_from_bytes_not.o(.text)
    */metldr2/src/mfc.o(.text._ZN8mfc_baseC1Ev)
    */metldr2/src/mfc.o(.text._ZN8mfc_baseC2Ev)
    */metldr2/src/mfc.o(.text._Z14mbox_out_spacev)
    */metldr2/src/mfc.o(.text._Z9mfc_issuejyjjjj)
    */metldr2/src/mfc.o(.text._Z12mfc_tag_donej)
    */metldr2/src/mfc.o(.text._Z19mbox_out_intr_writej)
    */metldr2/src/mfc.o(.text._Z14mbox_out_writej)
    */metldr2/src/mfc.o(.text._Z12mbox_in_readPj)
    */metldr2/src/mfc.o(.text._Z14mbox_in_read64Py)
    */lv0ldr/src/util/cxx_runtime.o(.text._ZdlPv)
    */lv0ldr/src/util/cxx_runtime.o(.text.__cxa_pure_virtual)
    */lv1ldr/src/auth_header.o(.text._ZN9sce_image12get_sectionsEv)
    */lv1ldr/src/auth_header.o(.text._ZN9sce_image17get_section_countEPj)
    */lv1ldr/src/auth_header.o(.text._ZN9sce_image13get_key_countEPj)
    */lv1ldr/src/auth_header.o(.text._ZN9sce_image14get_ext_headerEPjS0_)
    */metldr2/src/auth_check.o(.text._Z16check_sce_headerPKU8__vectorhPKvtj)
    */metldr2/src/auth_check.o(.text._Z17check_meta_headerPKU8__vectorhPK9auth_metaj)
    */metldr2/src/auth_check.o(.text._Z14check_sectionsP9sce_image)
    */metldr2/src/auth_check.o(.text._Z18check_control_infoPK12auth_controly)
    */metldr2/src/auth_check.o(.text._Z16check_ext_headerP9sce_image)
    */metldr2/src/auth_check.o(.text._ZN9sce_image12get_app_infoEPj)
    */lv0ldr/src/boot/exit.o(.text.exit)
    */lv0ldr/src/util/memcmp.o(.text.memcmp)
    */isoldr/src/memset.o(.text.memset)
    */isoldr/src/memcpy.o(.text.memcpy)
    *(.text .text.* .gnu.linkonce.t.*)
  }

  /* .rodata: the loader's own constants and vtables, two writable keys of
   * loader.cpp's (the image has them here), the crypto library's
   * constants (16-byte constants are merged: each is kept where it first
   * appears), the curve table, the header checks' tables and the shuffle
   * table */
  .rodata ALIGN(0x10) :
  {
    */metldr2/src/main.o(.rodata.ls_bottom_0)
    */metldr2/src/main.o(.rodata.ls_bottom_32)
    */metldr2/src/main.o(.rodata.ls_bottom_48)
    */metldr2/src/loader.o(.rodata.cst16)
    */metldr2/src/loader.o(.rodata.mldr_curve)
    *(.rodata._ZTV6cipher)
    */metldr2/src/loader.o(.data.mldr_header_key)
    */metldr2/src/loader.o(.data.mldr_header_iv)
    */metldr2/src/authenticator.o(.rodata.cst16)
    *(.rodata._ZTV14ecdsa_verifier)
    *(.rodata._ZTV8verifier)
    *(.rodata._ZTV17aes256_cbc_cipher)
    *(.rodata._ZTV17aes128_ctr_cipher)
    *(.rodata._ZTV10dma_buffer)
    *(.rodata._ZTV17tagged_dma_buffer)
    *(.rodata._ZTV12local_buffer)
    */metldr2/src/auth_segments.o(.rodata.cst16)
    */isoldr/src/*.o(.rodata.cst16)
    */crypto/*.o(EXCLUDE_FILE(*ec_curve_table.o) .rodata .rodata.*)
    */lv0ldr/crypto/ec_curve_table.o(.rodata .rodata.*)
    */metldr2/src/auth_data.o(.rodata.key_slots)
    */metldr2/src/auth_data.o(.rodata.digest_slots)
    */metldr2/src/auth_data.o(.rodata.sig_sizes)
    */metldr2/src/auth_check.o(.rodata.cst16)
    */metldr2/src/auth_data.o(.rodata.control_digest)
    */lv0ldr/src/util/shuffle_table.o(.rodata .rodata.*)
    *(.rodata .rodata.* .gnu.linkonce.r.*)
  }

  .data :
  {
    */metldr2/src/loader.o(.data.mldr_public_key)
    *(.data .data.* .gnu.linkonce.d.*)
  }

  .ctors ALIGN(0x10) : { KEEP(*(.ctors)) __CTOR_END__ = .; }
  .dtors : { KEEP(*(.dtors)) }

  .bss ALIGN(0x10) :
  {
    */metldr2/src/loader_global.o(.bss.g_loader)
    */metldr2/src/authenticator.o(.bss.g_auth_area)
    */metldr2/src/auth_buffers.o(.bss.g_part_area)
    */metldr2/src/auth_buffers.o(.bss.g_part_digest)
    */metldr2/src/auth_buffers.o(.bss.g_header)
    */isoldr/src/cipher_aes128_ctr.o(.bss.g_aes128_ctr)
    */isoldr/src/cipher_aes256_cbc.o(.bss.g_aes256_cbc)
    */isoldr/src/verifier_ecdsa.o(.bss.verify_hash)
    */isoldr/src/hmac_digest.o(.bss.g_hmac)
    */isoldr/src/dma_buffer.o(.bss.g_dma_mfc)
    *(.bss .bss.* .gnu.linkonce.b.*)
    *(COMMON)
  }

  /* leave scrubs up to here: metldr's end of memory, as metldr's own */
  _end = 0x12bf0;

  /DISCARD/ : { *(.comment) *(.note*) *(.eh_frame) }
}

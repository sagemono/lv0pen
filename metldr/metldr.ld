ENTRY(entry)

SECTIONS
{
  . = 0x400;

  .text :
  {
    */metldr/src/entry.o(.text)
    */lv0ldr/src/boot/crt0.o(.text)
    */metldr/src/loader_global.o(.text._Z41__static_initialization_and_destruction_0ii)
    */metldr/src/loader_global.o(.text._GLOBAL__I_g_loader)
    */lv0ldr/src/util/memcpy.o(.text.memcpy)
    */metldr/src/main.o(.text.main)
    *(.gnu.linkonce.t._ZN6cipherD2Ev)
    *(.gnu.linkonce.t._ZN6cipherD1Ev)
    *(.gnu.linkonce.t._ZN6cipherD0Ev)
    *(.gnu.linkonce.t._ZN17aes128_ctr_cipherD1Ev)
    *(.gnu.linkonce.t._ZN17aes128_ctr_cipherD0Ev)
    *(.gnu.linkonce.t._ZN17aes256_cbc_cipherD1Ev)
    *(.gnu.linkonce.t._ZN17aes256_cbc_cipherD0Ev)
    */metldr/src/loader.o(.text._ZN6loaderC2Ev)
    */metldr/src/loader.o(.text._ZN6loaderC1Ev)
    */metldr/src/loader.o(.text._ZN6loader12read_requestEv)
    */metldr/src/loader.o(.text._ZN6loader13load_segmentsEPj)
    */metldr/src/loader.o(.text._ZN6loader11load_headerEv)
    */metldr/src/loader.o(.text._ZN6loader4loadEPj)
    */metldr/src/loader.o(.text._ZN6loader3runEPj)
    */metldr/src/authenticator.o(.text._ZN9elf_image4loadEPKv)
    *(.gnu.linkonce.t._ZN8verifierD2Ev)
    *(.gnu.linkonce.t._ZN8verifierD1Ev)
    *(.gnu.linkonce.t._ZN8verifierD0Ev)
    *(.gnu.linkonce.t._ZN14ecdsa_verifierD1Ev)
    *(.gnu.linkonce.t._ZN14ecdsa_verifierD0Ev)
    *(.gnu.linkonce.t._ZN11hmac_digestC1Ev)
    */metldr/src/authenticator.o(.text._ZN13authenticatorC1Ev)
    */metldr/src/authenticator.o(.text._ZN13authenticatorC2Ev)
    */metldr/src/authenticator.o(.text._ZN13authenticator10set_offsetEy)
    */metldr/src/authenticator.o(.text._ZN13authenticator11load_headerEjPKhS1_S1_PKjPP10dma_bufferj)
    */metldr/src/authenticator.o(.text._Z41__static_initialization_and_destruction_0ii)
    */metldr/src/authenticator.o(.text._GLOBAL__I__ZN9elf_image4loadEPKv)
    */metldr/src/authenticator.o(.text._GLOBAL__D__ZN9elf_image4loadEPKv)
    */metldr/src/cipher_aes256_cbc.o(.text._ZN17aes256_cbc_cipher7set_keyEPKhPK9cipher_iv)
    */metldr/src/cipher_aes256_cbc.o(.text._ZN17aes256_cbc_cipher7decryptEPKviPv)
    */metldr/src/cipher_aes256_cbc.o(.text._ZN17aes256_cbc_cipherC1Ev)
    */metldr/src/cipher_aes256_cbc.o(.text._ZN17aes256_cbc_cipherC2Ev)
    */metldr/src/auth_elf.o(.text._ZN13authenticator15read_elf_headerEP10Elf32_Ehdr)
    */metldr/src/auth_elf.o(.text._ZN13authenticator19read_program_headerEjP10Elf32_Phdr)
    */metldr/src/cipher_aes128_ctr.o(.text._ZN17aes128_ctr_cipher7set_keyEPKhPK9cipher_iv)
    */metldr/src/cipher_aes128_ctr.o(.text._ZN17aes128_ctr_cipher7decryptEPKviPv)
    */metldr/src/cipher_aes128_ctr.o(.text._ZN17aes128_ctr_cipherC1Ev)
    */metldr/src/cipher_aes128_ctr.o(.text._ZN17aes128_ctr_cipherC2Ev)
    */metldr/src/verifier_ecdsa.o(.text._ZN14ecdsa_verifierC1EPKhj)
    */metldr/src/verifier_ecdsa.o(.text._ZN14ecdsa_verifierC2EPKhj)
    */metldr/src/verifier_ecdsa.o(.text._ZN14ecdsa_verifier6verifyEPKhiS1_)
    */metldr/src/auth_transfer.o(.text._ZN13authenticator10check_typeEj)
    */metldr/src/auth_transfer.o(.text._ZN13authenticator16check_sce_headerEj)
    */metldr/src/auth_transfer.o(.text._ZN13authenticator12get_app_infoEP13auth_app_info)
    */metldr/src/auth_transfer.o(.text._ZN9auth_sink6appendEPKU8__vectorhS2_)
    */metldr/src/auth_transfer.o(.text._ZN13authenticator16drain_read_queueEv)
    */metldr/src/auth_transfer.o(.text._ZN13authenticator12load_segmentEjjyPP10dma_bufferiS2_i)
    */metldr/src/auth_decrypt.o(.text._ZN13authenticator18transfer_encryptedEv)
    */metldr/src/elf_reader.o(.text._ZN9elf_image10get_headerEP10Elf32_Ehdr)
    */metldr/src/elf_reader.o(.text._ZN9elf_image18get_program_headerEjP10Elf32_Phdr)
    */metldr/src/hmac_digest.o(.text._ZN11hmac_digest4initEPKhj)
    */metldr/src/hmac_digest.o(.text._ZN11hmac_digest5finalEPh)
    */metldr/src/hmac_digest.o(.text._ZN11hmac_digest6updateEPKhi)
    */metldr/src/auth_section.o(.text._ZN13authenticator12find_sectionEjjP12auth_section)
    */lv0ldr/src/util/memcmp.o(.text.memcmp)
    */metldr/src/auth_buffers.o(.text._ZN13authenticator21verify_section_digestEPK12auth_section)
    */metldr/src/auth_buffers.o(.text._ZN13authenticator17save_header_pieceEPK10dma_buffer)
    */metldr/src/auth_buffers.o(.text._ZN13authenticator20restore_header_pieceEPK10dma_buffer)
    */metldr/src/auth_buffers.o(.text._ZN13authenticator7prependEP10dma_bufferj)
    */lv0ldr/src/dma/dma_queue.o(.text._ZN9dma_queue11add_writtenEP10dma_buffer)
    */lv0ldr/src/dma/dma_queue.o(.text._ZN9dma_queue4openEyjyj)
    */lv0ldr/src/dma/dma_queue.o(.text._ZN9dma_queueC2Ev)
    */lv0ldr/src/dma/dma_queue.o(.text._ZN9dma_queueC1Ev)
    */lv0ldr/src/dma/dma_queue.o(.text._ZN9dma_queue12enqueue_readEP10dma_buffer)
    */lv0ldr/src/dma/dma_queue.o(.text._ZN9dma_queue13enqueue_writeEP10dma_buffer)
    */lv0ldr/src/dma/dma_queue.o(.text._ZN9dma_queue7dequeueEPP10dma_bufferP9list_nodeMS0_FbvE)
    */lv0ldr/src/dma/dma_queue.o(.text._ZN9dma_queue5drainEP9list_nodeM10dma_bufferFbvE)
    */lv0ldr/src/dma/dma_queue.o(.text._ZN9dma_queue5closeEv)
    */lv0ldr/src/dma/dma_queue.o(.text._ZN9dma_queue13dequeue_writeEPP10dma_buffer)
    */lv0ldr/src/dma/dma_queue.o(.text._ZN9dma_queue12dequeue_readEPP10dma_buffer)
    */lv0ldr/src/dma/dma_queue.o(.text._ZN10list_entryC1Ev)
    */lv0ldr/src/dma/dma_queue.o(.text._ZN10list_entryC2Ev)
    */lv0ldr/src/dma/dma_buffer.o(.text._ZN10dma_bufferC2Ev)
    */lv0ldr/src/dma/dma_buffer.o(.text._ZN10dma_bufferC1Ev)
    */lv0ldr/src/dma/dma_buffer.o(.text._ZN10dma_buffer10set_bufferEjj)
    */lv0ldr/src/dma/dma_buffer.o(.text._ZN17tagged_dma_bufferC2Ej)
    */lv0ldr/src/dma/dma_buffer.o(.text._ZN17tagged_dma_bufferC1Ej)
    */lv0ldr/src/dma/dma_buffer.o(.text._ZN17tagged_dma_buffer8get_doneEv)
    */lv0ldr/src/dma/dma_buffer.o(.text._ZN17tagged_dma_buffer8put_doneEv)
    */lv0ldr/src/dma/dma_buffer.o(.text._ZN17tagged_dma_buffer9max_chunkEj)
    */lv0ldr/src/dma/dma_buffer.o(.text._ZN17tagged_dma_buffer8transferEyyjj)
    *(.gnu.linkonce.t._ZN7dma_mfcC1Ev)
    */lv0ldr/src/dma/dma_buffer.o(.text._Z41__static_initialization_and_destruction_0ii)
    */lv0ldr/src/dma/dma_buffer.o(.text._GLOBAL__I__ZN10dma_bufferC2Ev)
    */lv0ldr/src/dma/dma_buffer_io.o(.text._ZN17tagged_dma_buffer3putEyjPj)
    */lv0ldr/src/dma/dma_buffer_io.o(.text._ZN17tagged_dma_buffer3getEyjPj)
    */metldr/src/local_buffer.o(.text._ZN12local_bufferC2Ev)
    */metldr/src/local_buffer.o(.text._ZN12local_bufferC1Ev)
    */metldr/src/local_buffer.o(.text._ZN12local_buffer3getEyjPj)
    */metldr/src/local_buffer.o(.text._ZN12local_buffer8get_doneEv)
    */metldr/src/local_buffer.o(.text._ZN12local_buffer8put_doneEv)
    */metldr/src/local_buffer.o(.text._ZN12local_buffer3putEyjPj)
    */lv0ldr/crypto/aes_modes.o(.text)
    */lv0ldr/crypto/sha1_digest.o(.text)
    */lv0ldr/crypto/hmac_sha1.o(.text)
    */lv0ldr/crypto/aes.o(.text)
    */lv0ldr/crypto/sha1.o(.text)
    */lv0ldr/crypto/sha1_transform.o(.text)
    */lv0ldr/crypto/ecdsa_id.o(.text)
    */lv0ldr/crypto/ec_curves.o(.text)
    */lv0ldr/crypto/ecdsa.o(.text)
    */lv0ldr/crypto/ec.o(.text)
    */lv0ldr/crypto/ec_mul2.o(.text)
    */lv0ldr/crypto/bn.o(.text)
    */lv0ldr/crypto/bn_range.o(.text)
    */lv0ldr/crypto/ec_curve_valid.o(.text)
    */metldr/src/mfc.o(.text._ZN8mfc_baseC2Ev)
    */metldr/src/mfc.o(.text._ZN8mfc_baseC1Ev)
    */metldr/src/mfc.o(.text._Z14mbox_out_spacev)
    */metldr/src/mfc.o(.text._Z9mfc_issuejyjjjj)
    */metldr/src/mfc.o(.text._Z12mfc_tag_donej)
    */metldr/src/mfc.o(.text._Z14mbox_out_writej)
    */metldr/src/mfc.o(.text._Z12mbox_in_readPj)
    */metldr/src/mfc.o(.text._Z19mbox_out_intr_writej)
    */metldr/src/mfc.o(.text._Z14mbox_in_read64Py)
    */lv0ldr/src/util/cxx_runtime.o(.text._ZdlPv)
    */lv0ldr/src/util/cxx_runtime.o(.text.__cxa_pure_virtual)
    */lv0ldr/src/boot/exit.o(.text.exit)
    */lv0ldr/src/util/memset.o(.text.memset)
    *(.text .text.* .gnu.linkonce.t.*)
  } =0x00200000

  .rodata :
  {
    */metldr/src/main.o(.gnu.linkonce.r.*)
    */metldr/src/main.o(.rodata .rodata.*)
    *(.gnu.linkonce.r._ZTV6cipher)
    *(.gnu.linkonce.r._ZTV17aes128_ctr_cipher)
    *(.gnu.linkonce.r._ZTV17aes256_cbc_cipher)
    */metldr/src/loader.o(.gnu.linkonce.r.*)
    */metldr/src/loader.o(.rodata .rodata.*)
    *(.gnu.linkonce.r._ZTV8verifier)
    *(.gnu.linkonce.r._ZTV14ecdsa_verifier)
    */metldr/src/authenticator.o(.gnu.linkonce.r.*)
    */metldr/src/authenticator.o(.rodata .rodata.*)
    */metldr/src/cipher_aes256_cbc.o(.gnu.linkonce.r.*)
    */metldr/src/cipher_aes256_cbc.o(.rodata .rodata.*)
    */metldr/src/cipher_aes128_ctr.o(.gnu.linkonce.r.*)
    */metldr/src/cipher_aes128_ctr.o(.rodata .rodata.*)
    */metldr/src/verifier_ecdsa.o(.gnu.linkonce.r.*)
    */metldr/src/verifier_ecdsa.o(.rodata .rodata.*)
    */metldr/src/auth_transfer.o(.gnu.linkonce.r.*)
    */metldr/src/auth_transfer.o(.rodata .rodata.*)
    */lv0ldr/src/dma/dma_queue.o(.gnu.linkonce.r.*)
    */lv0ldr/src/dma/dma_queue.o(.rodata .rodata.*)
    */lv0ldr/src/dma/dma_buffer.o(.gnu.linkonce.r.*)
    */lv0ldr/src/dma/dma_buffer.o(.rodata .rodata.*)
    */lv0ldr/src/dma/dma_buffer_io.o(.gnu.linkonce.r.*)
    */lv0ldr/src/dma/dma_buffer_io.o(.rodata .rodata.*)
    */metldr/src/local_buffer.o(.gnu.linkonce.r.*)
    */metldr/src/local_buffer.o(.rodata .rodata.*)
    */lv0ldr/crypto/aes_modes.o(.gnu.linkonce.r.*)
    */lv0ldr/crypto/aes_modes.o(.rodata .rodata.*)
    */lv0ldr/crypto/aes.o(.gnu.linkonce.r.*)
    */lv0ldr/crypto/aes.o(.rodata .rodata.*)
    */lv0ldr/crypto/sha1.o(.gnu.linkonce.r.*)
    */lv0ldr/crypto/sha1.o(.rodata .rodata.*)
    */lv0ldr/crypto/sha1_transform.o(.gnu.linkonce.r.*)
    */lv0ldr/crypto/sha1_transform.o(.rodata .rodata.*)
    */lv0ldr/crypto/bn.o(.gnu.linkonce.r.*)
    */lv0ldr/crypto/bn.o(.rodata .rodata.*)
    */lv0ldr/crypto/ec_curve_table.o(.gnu.linkonce.r.*)
    */lv0ldr/crypto/ec_curve_table.o(.rodata .rodata.*)
    */lv0ldr/src/util/shuffle_table.o(.gnu.linkonce.r.*)
    */lv0ldr/src/util/shuffle_table.o(.rodata .rodata.*)
    *(.rodata .rodata.* .gnu.linkonce.r.*)
  }

  . = ALIGN(0x80);
  .data : { KEEP(*/metldr/src/entry.o(.data)) *(.data .data.* .gnu.linkonce.d.*) }
  .ctors : { KEEP(*(.ctors)) __CTOR_END__ = .; }
  .dtors : { KEEP(*(.dtors)) }
  .bss : { *(.bss .bss.* .gnu.linkonce.b.*) *(COMMON) }
  _end = 0x12bf0;

  /DISCARD/ : { *(.comment) *(.note*) *(.eh_frame) }
}
